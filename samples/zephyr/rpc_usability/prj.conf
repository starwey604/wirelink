## CMakeLists.txt
```
# SPDX-License-Identifier: Apache-2.0
cmake_minimum_required(VERSION 3.28.0)
set(WIRELINK_ROOT "${CMAKE_CURRENT_LIST_DIR}/../../..")
list(APPEND ZEPHYR_EXTRA_MODULES ${WIRELINK_ROOT})
find_package(Zephyr REQUIRED HINTS $ENV{ZEPHYR_BASE})
project(wirelink_rpc_usability)
include(${WIRELINK_ROOT}/cmake/WirelinkWlc.cmake)
if(DEFINED WIRELINK_RPC_TEST_CAPACITY)
  message(FATAL_ERROR "The current kernel has four fixed call slots; the one-slot capacity knob was removed")
endif()
wirelink_wlc_generate(TARGET validation_protocol SCHEMA "${CMAKE_CURRENT_LIST_DIR}/rpc_validation.wl"
  PROFILE "${CMAKE_CURRENT_LIST_DIR}/rpc_validation.bind.wl")
target_sources(app PRIVATE src/main.c)
target_include_directories(app PRIVATE "${WIRELINK_ROOT}/examples/common")
target_link_libraries(app PRIVATE validation_protocol)
```

## sample.yaml
```
# SPDX-License-Identifier: Apache-2.0
sample:
  name: Wirelink typed RPC ownership
  description: Four-call admission, owned values, chaining, physical leases and deadlines
common:
  tags: [wirelink, wlc, rpc]
  platform_allow: [native_sim, qemu_cortex_m3, qemu_riscv32, qemu_x86_64]
  integration_platforms: [native_sim, qemu_cortex_m3, qemu_riscv32, qemu_x86_64]
  timeout: 60
  harness: console
  harness_config:
    type: one_line
    regex: ['RPC_OWNERSHIP ALL PASS']
tests:
  sample.wirelink.rpc_usability: {}
```

## prj.conf
```kconfig
CONFIG_MAIN_STACK_SIZE=8192
CONFIG_PRINTK=y
CONFIG_LOG=n
CONFIG_SPEED_OPTIMIZATIONS=y

CONFIG_WIRELINK=y
CONFIG_WIRELINK_PACKET_LOOPBACK=y
CONFIG_STDOUT_CONSOLE=y
```

## boards/dm_mc02_stm32h723xx.conf
```kconfig
# Standalone H1: no actuators, persistent storage, or USB driver changes.
CONFIG_CAN=n
CONFIG_PWM=n
CONFIG_LED=n
CONFIG_SERIAL=n
CONFIG_UART_CONSOLE=n
CONFIG_USE_SEGGER_RTT=y
CONFIG_RTT_CONSOLE=y
CONFIG_CONSOLE=y
CONFIG_SEGGER_RTT_INIT_MODE_ALWAYS=y
CONFIG_SEGGER_RTT_BUFFER_SIZE_UP=4096
CONFIG_SEGGER_RTT_MODE_NO_BLOCK_SKIP=y
```

## boards/esp32s3_devkitc_esp32s3_procpu.overlay
```dts
/* SPDX-License-Identifier: Apache-2.0 */

/ {
	chosen {
		zephyr,console = &usb_serial;
		zephyr,shell-uart = &usb_serial;
	};
};

&usb_serial {
	status = "okay";
};
```

## src/main.c
```c
/* SPDX-License-Identifier: Apache-2.0 */
#include <zephyr/kernel.h>
#include <zephyr/sys/printk.h>
#include "rpc_validation_kernel.h"
#include "loopback_owner.h"
static rpc_validation_kernel_t endpoints[2];
static example_pair_t pair;
static unsigned completions, chained, executions;
static bool chain;
static response_value_t saved;
static large_value_t large_saved;
static wl_kernel_result_t terminal;
static request_value_t request(int32_t input) {
  return (request_value_t){.has_input = true, .input = input,
    .has_name = true, .name = {.length = 3, .data = {'a', 0, 'b'}}};
}
static int32_t execute(void *user, const request_t *input, response_value_t *output) {
  (void)user; ++executions;
  EXAMPLE_REQUIRE(input->name.length == 3 && memcmp(input->name.data, "a\0b", 3) == 0);
  if (input->input == -1 || input->input == INT32_MAX) return 17;
  output->has_output = output->has_name = true; output->output = input->input + 1;
  output->name.length = input->name.length; memcpy(output->name.data, input->name.data, input->name.length); return 0;
}
static int32_t download(void *user, const empty_t *input, large_value_t *output) {
  (void)user; (void)input; output->has_data = true; output->data.length = sizeof(output->data.data);
  memset(output->data.data, 0xa5, output->data.length); return 0;
}
static void done(void *user, wl_kernel_result_t result, const response_t *output) {
  (void)user; terminal = result;
  if (result.outcome == WL_KERNEL_SUCCESS) {
    EXAMPLE_REQUIRE(output && response_value_from_view(output, &saved) == WL_CODEC_OK);
    EXAMPLE_REQUIRE(saved.output == 42 && saved.name.length == 3 && memcmp(saved.name.data, "a\0b", 3) == 0);
  }
  ++completions;
  if (chain && !chained) {
    ++chained; request_value_t next = request(41); wl_kernel_call_handle_t handle;
    EXAMPLE_REQUIRE(rpc_validation_kernel_execute_start(&endpoints[0], &next, pair.now, 500, done, NULL, &handle) == WL_OK);
  }
}
static void downloaded(void *user, wl_kernel_result_t result, const large_t *output) {
  (void)user;
  EXAMPLE_REQUIRE(result.outcome == WL_KERNEL_SUCCESS && output && large_value_from_view(output, &large_saved) == WL_CODEC_OK);
  ++completions;
}
static void setup(void) {
  example_pair_init(&pair, &endpoints[0].core, &endpoints[1].core);
  const rpc_validation_kernel_handlers_t handlers = {.on_rpc_execute = execute, .on_rpc_download = download};
  for (unsigned side = 0; side < 2; ++side)
    EXAMPLE_REQUIRE(rpc_validation_kernel_init(&endpoints[side], &pair.ports[side], &handlers, NULL, NULL) == WL_OK);
}
int main(void) {
  setup();
  wl_kernel_call_handle_t handle;
  for (unsigned slot = 0; slot < 4; ++slot) {
    request_value_t value = request(41);
    EXAMPLE_REQUIRE(rpc_validation_kernel_execute_start(&endpoints[0], &value, pair.now, 500, done, NULL, &handle) == WL_OK);
    memset(&value, 0, sizeof(value));
  }
  request_value_t value = request(41);
  EXAMPLE_REQUIRE(rpc_validation_kernel_execute_start(&endpoints[0], &value, pair.now, 500, done, NULL, &handle) == WL_ERR_WOULD_BLOCK);
  chain = true; example_pair_wait(&pair, &completions, 5); chain = false;
  EXAMPLE_REQUIRE(chained == 1 && executions == 5);
  value = request(-1);
  EXAMPLE_REQUIRE(rpc_validation_kernel_execute_start(&endpoints[1], &value, pair.now, 500, done, NULL, &handle) == WL_OK);
  example_pair_wait(&pair, &completions, 6);
  EXAMPLE_REQUIRE(terminal.outcome == WL_KERNEL_REJECTED && terminal.status == 17);
  empty_value_t empty = {0};
  EXAMPLE_REQUIRE(rpc_validation_kernel_download_start(&endpoints[0], &empty, pair.now, 500, downloaded, NULL, &handle) == WL_OK);
  example_pair_wait(&pair, &completions, 7);
  EXAMPLE_REQUIRE(large_saved.data.length == 2023);
  for (size_t i = 0; i < large_saved.data.length; ++i) EXAMPLE_REQUIRE(large_saved.data.data[i] == 0xa5);
  example_pair_close(&pair);
  EXAMPLE_REQUIRE(saved.output == 42 && large_saved.data.data[2022] == 0xa5);
  setup(); pair.now = UINT32_MAX - 2; value = request(41);
  EXAMPLE_REQUIRE(rpc_validation_kernel_execute_start(&endpoints[0], &value, pair.now, 5, done, NULL, &handle) == WL_OK);
  EXAMPLE_REQUIRE(rpc_validation_kernel_step(&endpoints[0], pair.now) == WL_OK);
  /* The model driver retains the physical TX source; timeout is logical only. */
  pair.now += 5;
  EXAMPLE_REQUIRE(rpc_validation_kernel_step(&endpoints[0], pair.now) == WL_OK);
  EXAMPLE_REQUIRE(completions == 8 && terminal.outcome == WL_KERNEL_TIMED_OUT);
  EXAMPLE_REQUIRE(wl_packet_tx_active(&pair.ports[0]) && pair.cable.directions[0].pending);
  example_pair_close(&pair); /* Stop really abandons the model driver's borrow. */
  EXAMPLE_REQUIRE(completions == 8 && saved.output == 42);
  setup();
  EXAMPLE_REQUIRE(wl_kernel_cancel(&endpoints[0].core, handle) != WL_OK);
  example_pair_close(&pair);
  printk("RPC_OWNERSHIP ALL PASS slots=4 chained=1 bytes=2023 core_clock=none\n");
  return 0;
}
```
