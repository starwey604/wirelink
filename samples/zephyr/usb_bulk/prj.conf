## CMakeLists.txt
```
# SPDX-License-Identifier: Apache-2.0

cmake_minimum_required(VERSION 3.28.0)

set(WIRELINK_ROOT "${CMAKE_CURRENT_LIST_DIR}/../../..")
list(APPEND ZEPHYR_EXTRA_MODULES ${WIRELINK_ROOT})

find_package(Zephyr REQUIRED HINTS $ENV{ZEPHYR_BASE})
project(wirelink_usb_bulk)

include(${WIRELINK_ROOT}/cmake/WirelinkWlc.cmake)
wirelink_wlc_generate_codec(TARGET usb_control_codec
  SCHEMA "${WIRELINK_ROOT}/tests/fixtures/wlc/current/control.wl")
target_link_libraries(app PRIVATE usb_control_codec)
target_sources(app PRIVATE src/main.c src/application.c)
```

## Kconfig
```
# SPDX-License-Identifier: Apache-2.0

source "Kconfig.zephyr"

config SAMPLE_WIRELINK_USB_CPU_STATS
	bool "Collect ESP32-S3 USB CPU cycle telemetry"
	depends on SOC_SERIES_ESP32S3
	help
	  Counts the application pass (including one kernel step), adapter callbacks,
	  sink and service. Optional external driver hooks report zero when absent.
	  Output is wirelink_usb_kernel_cpu_v2; it is not the old polling observer
	  or the dedicated K4 benchmark. Atomic cycle sums are explicitly modulo32.
	  Off by default. No platform driver files are changed by this sample.
```

## sample.yaml
```
# SPDX-License-Identifier: Apache-2.0

sample:
  name: Wirelink USB vendor bulk endpoint
  description: Wirelink echo and sequential object receiver over an interrupt-driven USB class
tests:
  sample.wirelink.usb_bulk:
    build_only: true
    platform_allow:
      - esp32s3_devkitc/esp32s3/procpu
    tags:
      - usb
      - wirelink
  sample.wirelink.usb_bulk.cpu_stats:
    build_only: true
    platform_allow:
      - esp32s3_devkitc/esp32s3/procpu
    extra_conf_files:
      - cpu_stats.conf
    tags:
      - usb
      - wirelink
      - benchmark
```

## prj.conf
```kconfig
# SPDX-License-Identifier: Apache-2.0

CONFIG_WIRELINK=y
CONFIG_CSPRNG_NEEDED=y
CONFIG_WIRELINK_PLATFORM=y
CONFIG_WIRELINK_FRAMING_PRIMITIVES=y
CONFIG_WIRELINK_ZEPHYR_USB_BULK=y

CONFIG_USB_DEVICE_STACK_NEXT=y
CONFIG_UDC_DWC2_DMA=n
CONFIG_CDC_ACM_SERIAL_INITIALIZE_AT_BOOT=n

CONFIG_WIRELINK_ZEPHYR_USB_BULK_DEVICE=y
CONFIG_WIRELINK_ZEPHYR_USB_BULK_PRODUCT="Wirelink USB bulk endpoint"

CONFIG_PRINTK=y
CONFIG_LOG=n
CONFIG_MAIN_STACK_SIZE=4096
CONFIG_HEAP_MEM_POOL_SIZE=0
```

## cpu_stats.conf
```kconfig
# SPDX-License-Identifier: Apache-2.0

# Optional benchmark overlay; normal sample builds leave telemetry disabled.
CONFIG_SAMPLE_WIRELINK_USB_CPU_STATS=y
```

## src/main.c
```c
/* SPDX-License-Identifier: Apache-2.0 */
#include <zephyr/kernel.h>
#include <zephyr/sys/printk.h>
#include "application.h"
#include "wirelink/zephyr/node.h"
#include "wirelink/platform.h"
#include "wirelink/zephyr/usb_bulk.h"
#include "wirelink/zephyr/detail/timeout.h"

static wl_node_t node;
static wl_zephyr_usb_bulk_t adapter;
static usb_sample_application_t application;
static uint8_t snapshots[WL_ENDPOINT_TX_COUNT][USB_SAMPLE_FRAME_MAX];
static uint8_t rx[WL_PACKET_RX_SLOTS][WL_ZEPHYR_USB_BULK_RX_UNIT(USB_SAMPLE_FRAME_MAX)]
    __aligned(WL_NODE_BUFFER_ALIGN);
#if defined(CONFIG_SAMPLE_WIRELINK_USB_CPU_STATS)
#include <esp_cpu.h>
typedef struct { atomic_t calls, cycles, maximum; } irq_region_t;
static irq_region_t dwc2_isr, dwc2_thread, usbd_thread;
static uint64_t pass_calls, pass_cycles;
static uint32_t pass_max;
uint32_t wirelink_usb_cpu_cycle_count(void) { return (uint32_t)esp_cpu_get_cycle_count(); }
static void record(irq_region_t *region, uint32_t cycles) {
  atomic_inc(&region->calls); atomic_add(&region->cycles, (atomic_val_t)cycles);
  atomic_val_t previous = atomic_get(&region->maximum);
  while (cycles > (uint32_t)previous && !atomic_cas(&region->maximum, previous, (atomic_val_t)cycles))
    previous = atomic_get(&region->maximum);
}
/* Optional externally instrumented driver hooks; zero calls means unobserved. */
void wirelink_usb_cpu_record_dwc2_isr(uint32_t cycles) { record(&dwc2_isr, cycles); }
void wirelink_usb_cpu_record_dwc2_thread(uint32_t cycles) { record(&dwc2_thread, cycles); }
void wirelink_usb_cpu_record_usbd_thread(uint32_t cycles) { record(&usbd_thread, cycles); }
static uint32_t adapter_cycles(void *user) { (void)user; return wirelink_usb_cpu_cycle_count(); }
static void print_region(const char *name, const irq_region_t *region) {
  printk("wirelink_usb_kernel_cpu_v2,region,%s,calls,%u,cycles_mod32,%u,max,%u\n", name,
    (unsigned)atomic_get(&region->calls), (unsigned)atomic_get(&region->cycles),
    (unsigned)atomic_get(&region->maximum));
}
static void print_stats(void) {
  wl_zephyr_usb_bulk_stats_t stats;
  wl_zephyr_usb_bulk_get_stats(&adapter, &stats);
  printk("wirelink_usb_kernel_cpu_v2,region,application_pass,calls,%llu,cycles,%llu,max,%u\n",
    (unsigned long long)pass_calls, (unsigned long long)pass_cycles, pass_max);
  printk("wirelink_usb_kernel_cpu_v2,rx,%u,tx,%u,rx_callback_cycles_mod32,%u,tx_callback_cycles_mod32,%u,"
    "sink_cycles_mod32,%u,active_service_cycles_mod32,%u,errors,%u\n", stats.rx_completions,
    stats.tx_completions, stats.rx_callback_cycles, stats.tx_callback_cycles,
    stats.tx_sink_cycles, stats.active_service_cycles, stats.errors);
  print_region("dwc2_isr", &dwc2_isr); print_region("dwc2_thread", &dwc2_thread);
  print_region("usbd_thread", &usbd_thread);
}
#endif
static wl_err_t route(wl_endpoint_t *core, const wl_wire_frame_t *frame) {
  return usb_sample_dispatch(((wl_node_t *)core)->user, frame);
}
int main(void) {
  wl_environment_t environment = wl_platform_environment();
  uint32_t instance;
  int error = wl_session_next(environment.session, 0, &instance);
  if (error != WL_OK) { printk("Fresh USB instance unavailable: %d\n", error); return 1; }
  wl_node_layout_t layout = {.instance = instance,
    .storage = wl_endpoint_storage_uniform(snapshots[0], USB_SAMPLE_FRAME_MAX),
    .route = route, .user = &application,
    .rx_storage = rx[0], .rx_storage_size = sizeof(rx), .rx_unit_size = sizeof(rx[0]),
    .rx_frame_max = USB_SAMPLE_FRAME_MAX, .rx_wire_max = USB_SAMPLE_FRAME_MAX,
    .tx_frame_max = USB_SAMPLE_FRAME_MAX, .tx_wire_max = USB_SAMPLE_FRAME_MAX, .has_tx = 1};
  wl_zephyr_usb_bulk_config_t physical = {0};
#if defined(CONFIG_SAMPLE_WIRELINK_USB_CPU_STATS)
  physical.cycle_counter = adapter_cycles;
#endif
  error = wl_node_bind_transport(&node, &layout, wl_zephyr_usb_bulk_transport(&adapter, &physical));
  if (error != WL_OK) { printk("USB adapter init: %d\n", error); return 1; }
  error = wl_zephyr_usb_bulk_device_enable();
  if (error == WL_OK) printk("Wirelink kernel native/NONE raw echo + application object sink ready payload=%u chunk=%u\n",
    USB_SAMPLE_PAYLOAD_MAX, USB_SAMPLE_CHUNK_MAX);
#if defined(CONFIG_SAMPLE_WIRELINK_USB_CPU_STATS)
  uint32_t next_stats = k_uptime_get_32() + 1000;
#endif
  while (error == WL_OK) {
    uint32_t now = k_uptime_get_32();
    error = wl_zephyr_usb_bulk_service(&adapter);
    if (error == WL_ERR_WOULD_BLOCK) error = WL_OK;
    if (error == WL_ERR_IO && wl_zephyr_usb_bulk_rx_fault(&adapter) != WL_ZEPHYR_USB_RX_FAULT_NONE) {
      printk("USB RX fault=%d; explicit re-enumeration\n", wl_zephyr_usb_bulk_rx_fault(&adapter));
      error = wl_zephyr_usb_bulk_recover(&adapter);
      if (error == WL_ERR_WOULD_BLOCK) error = WL_OK;
    }
    if (error != WL_OK) break;
#if defined(CONFIG_SAMPLE_WIRELINK_USB_CPU_STATS)
    uint32_t began = wirelink_usb_cpu_cycle_count();
#endif
    error = usb_sample_pass(&application, &node.core, now);
#if defined(CONFIG_SAMPLE_WIRELINK_USB_CPU_STATS)
    uint32_t cycles = wirelink_usb_cpu_cycle_count() - began;
    ++pass_calls; pass_cycles += cycles; if (cycles > pass_max) pass_max = cycles;
#endif
    if (error == WL_ERR_CORRUPT_PAYLOAD || error == WL_ERR_NOT_SUPPORTED) {
      printk("USB rejected malformed/unsupported packet: %d\n", error); error = WL_OK;
    }
    if (error != WL_OK) break;
    if (application.report_pending && (int32_t)(now - application.report_due) >= 0 &&
        !application.output_pending && !wl_packet_tx_active(&node.port)) {
      printk("wirelink_object_rx_v1,transfer_id,%u,bytes,%llu,elapsed_ms,%u,crc32c,0x%08x,write_calls,%u\n",
        application.completed_id, (unsigned long long)application.completed_length,
        application.elapsed, application.completed_crc, application.completed_writes);
      application.report_pending = false;
    }
#if defined(CONFIG_SAMPLE_WIRELINK_USB_CPU_STATS)
    if ((int32_t)(now - next_stats) >= 0) { print_stats(); next_stats = now + 1000; }
#endif
    uint32_t maximum = usb_sample_deadline(&application, now);
    if (application.report_pending && (int32_t)(application.report_due - now) > 0 &&
        application.report_due - now < maximum) maximum = application.report_due - now;
#if defined(CONFIG_SAMPLE_WIRELINK_USB_CPU_STATS)
    if (next_stats - now < maximum) maximum = next_stats - now;
#endif
    uint32_t elapsed = k_uptime_get_32() - now;
    if (usb_sample_ready(&application, &node.core, now) || wl_zephyr_usb_bulk_ready(&adapter) ||
        (maximum != UINT32_MAX && elapsed >= maximum)) continue;
    error = wl_zephyr_usb_bulk_wait(&adapter,
        wl_zephyr_timeout_ms(maximum == UINT32_MAX ? maximum : maximum - elapsed));
    if (error == WL_ERR_NO_DATA) error = WL_OK;
  }
  printk("USB owner stopping: %d\n", error);
  usb_sample_close(&application);
  error = wl_zephyr_usb_bulk_device_disable();
  wl_err_t closed = wl_zephyr_node_close(&node, UINT32_MAX);
  return error == WL_OK && closed == WL_OK ? 0 : 1;
}
```

## src/application.c
```c
/* SPDX-License-Identifier: Apache-2.0 */
#include "application.h"
#include <string.h>

static wl_err_t status(usb_sample_application_t *app, uint32_t id, int phase, int code) {
  bulk_status_t value = {.has_transfer_id = true, .transfer_id = id,
    .has_phase = true, .phase = phase, .has_code = true, .code = code,
    .has_next_offset = true, .next_offset = app->next,
    .has_accepted_chunk_size = true, .accepted_chunk_size = app->chunk_size};
  if (bulk_status_encode(&value, app->pending, sizeof(app->pending), &app->pending_length) != WL_CODEC_OK)
    return WL_ERR_CORRUPT_PAYLOAD;
  app->pending_id = BULK_STATUS_MESSAGE_ID; app->output_pending = true; return WL_OK;
}
static wl_err_t begin(usb_sample_application_t *app, const wl_wire_frame_t *frame) {
  bulk_begin_t value;
  if (bulk_begin_decode(frame->payload, frame->length, &value) != WL_CODEC_OK ||
      !value.has_transfer_id || !value.has_total_length || !value.has_requested_chunk_size ||
      !value.has_object_crc32c) return WL_ERR_CORRUPT_PAYLOAD;
  int code = CONTROL_BULK_STATUS_OK;
  if (!value.transfer_id || !value.total_length || value.total_length > USB_SAMPLE_OBJECT_MAX ||
      !value.requested_chunk_size) code = CONTROL_BULK_STATUS_INVALID;
  else if (app->active) {
    if (value.transfer_id != app->transfer_id) code = CONTROL_BULK_STATUS_BUSY;
    else if (value.total_length != app->total || value.object_crc32c != app->expected_crc)
      code = CONTROL_BULK_STATUS_CONFLICT;
    else app->touched_at = app->now;
  } else if (value.transfer_id == app->completed_id) {
    if (value.total_length != app->completed_length || value.object_crc32c != app->completed_crc)
      code = CONTROL_BULK_STATUS_CONFLICT;
    else app->next = app->completed_length;
  } else {
    app->active = true; app->transfer_id = value.transfer_id; app->total = value.total_length;
    app->expected_crc = value.object_crc32c; app->crc = UINT32_MAX; app->next = 0;
    app->chunk_size = value.requested_chunk_size < USB_SAMPLE_CHUNK_MAX ? value.requested_chunk_size : USB_SAMPLE_CHUNK_MAX;
    app->writes = 0; app->started_at = app->touched_at = app->now;
  }
  return status(app, value.transfer_id, CONTROL_BULK_PHASE_BEGIN, code);
}
static wl_err_t chunk(usb_sample_application_t *app, const wl_wire_frame_t *frame) {
  bulk_chunk_t value;
  if (bulk_chunk_decode(frame->payload, frame->length, &value) != WL_CODEC_OK ||
      !value.has_transfer_id || !value.has_offset || !value.has_data)
    return WL_ERR_CORRUPT_PAYLOAD;
  int code = CONTROL_BULK_STATUS_OK;
  if (!app->active || value.transfer_id != app->transfer_id)
    code = CONTROL_BULK_STATUS_INVALID;
  else if (!value.data.length || value.data.length > app->chunk_size ||
      value.offset > app->total || value.data.length > app->total - value.offset)
    code = CONTROL_BULK_STATUS_INVALID;
  else if (value.offset > app->next ||
      (value.offset < app->next && value.data.length > app->next - value.offset))
    code = CONTROL_BULK_STATUS_OUT_OF_ORDER;
  if (code == CONTROL_BULK_STATUS_OK) {
    for (size_t i = 0; i < value.data.length; ++i)
      if (value.data.data[i] != (uint8_t)((uint8_t)(value.offset + i) ^ UINT8_C(0xa5))) {
        code = CONTROL_BULK_STATUS_INTEGRITY_FAILED; break;
      }
    if (code == CONTROL_BULK_STATUS_OK) {
      if (value.offset == app->next) {
        app->crc = usb_sample_crc32c_update(app->crc, value.data.data, value.data.length);
        app->next += value.data.length; ++app->writes;
      } else ++app->duplicates; /* This pattern sink can validate old bytes. */
      app->touched_at = app->now;
    }
  }
  return status(app, value.transfer_id, CONTROL_BULK_PHASE_CHUNK, code);
}
static wl_err_t end(usb_sample_application_t *app, const wl_wire_frame_t *frame) {
  bulk_end_t value;
  if (bulk_end_decode(frame->payload, frame->length, &value) != WL_CODEC_OK ||
      !value.has_transfer_id || !value.has_total_length || !value.has_object_crc32c)
    return WL_ERR_CORRUPT_PAYLOAD;
  int code = CONTROL_BULK_STATUS_OK;
  if (!app->active && value.transfer_id == app->completed_id && value.transfer_id != 0) {
    if (value.total_length != app->completed_length || value.object_crc32c != app->completed_crc)
      code = CONTROL_BULK_STATUS_CONFLICT;
  } else if (!app->active || value.transfer_id != app->transfer_id)
    code = CONTROL_BULK_STATUS_INVALID;
  else if (value.total_length != app->total || app->next != app->total)
    code = CONTROL_BULK_STATUS_OUT_OF_ORDER;
  else if ((app->crc ^ UINT32_MAX) != app->expected_crc || value.object_crc32c != app->expected_crc)
    code = CONTROL_BULK_STATUS_INTEGRITY_FAILED;
  else {
    app->active = false; ++app->commits;
    app->completed_id = app->transfer_id; app->completed_length = app->total;
    app->completed_crc = app->expected_crc; app->completed_writes = app->writes;
    app->elapsed = app->now - app->started_at; app->report_due = app->now + 100;
    app->report_pending = true;
  }
  return status(app, value.transfer_id, CONTROL_BULK_PHASE_END, code);
}
wl_err_t usb_sample_route(wl_endpoint_t *core, const wl_wire_frame_t *frame) {
  return usb_sample_dispatch(core->user, frame);
}
wl_err_t usb_sample_dispatch(usb_sample_application_t *app, const wl_wire_frame_t *frame) {
  /* A fair kernel may grant RX a turn before submitting the previous echo.
   * Retain that input without decoding or applying any business side effect. */
  if (app->output_pending) return WL_ERR_WOULD_BLOCK;
  switch (frame->message_id) {
    case BULK_BEGIN_MESSAGE_ID: return begin(app, frame);
    case BULK_CHUNK_MESSAGE_ID: return chunk(app, frame);
    case BULK_END_MESSAGE_ID: return end(app, frame);
    case BULK_ABORT_MESSAGE_ID: {
      bulk_abort_t value;
      if (bulk_abort_decode(frame->payload, frame->length, &value) != WL_CODEC_OK ||
          !value.has_transfer_id || !value.has_reason) return WL_ERR_CORRUPT_PAYLOAD;
      int code = CONTROL_BULK_STATUS_INVALID;
      if (app->active && value.transfer_id == app->transfer_id) {
        app->active = false; ++app->aborts; code = CONTROL_BULK_STATUS_ABORTED;
      }
      return status(app, value.transfer_id, CONTROL_BULK_PHASE_ABORT, code);
    }
    default:
      if (frame->length > sizeof(app->pending)) return WL_ERR_BUF_TOO_SMALL;
      memcpy(app->pending, frame->payload, frame->length); app->pending_length = frame->length;
      app->pending_id = frame->message_id; app->output_pending = true; return WL_OK;
  }
}
static wl_err_t flush(usb_sample_application_t *app, wl_endpoint_t *core) {
  if (!app->output_pending) return WL_OK;
  uint8_t *frame;
  size_t capacity = 0U;
  wl_err_t error = wl_endpoint_msg_claim(core, &frame, &capacity);
  if (error == WL_OK) {
    if (capacity < WL_WIRE_NATIVE_HEADER + app->pending_length)
      return WL_ERR_BUF_TOO_SMALL;
    if (app->pending_length)
      memcpy(frame + WL_WIRE_NATIVE_HEADER, app->pending, app->pending_length);
    error = wl_wire_frame_seal(frame, capacity, WL_WIRE_MSG, app->pending_id,
                               app->pending_length);
    if (error == WL_OK)
      error = wl_endpoint_msg_commit(core, WL_WIRE_NATIVE_HEADER + app->pending_length);
  }
  if (error == WL_OK) {
    app->output_pending = false;
    /* One queued application output is a finite owner wake, never a physical
     * completion. A BUSY attempt consumes it and waits for real I/O activity. */
    wl_packet_activity(core->port);
  }
  return error == WL_ERR_WOULD_BLOCK ? WL_OK : error;
}
static int tx_progress(const usb_sample_application_t *app, const wl_endpoint_t *core) {
  (void)app;
  return wl_packet_tx_ready(core->port) || (!wl_packet_tx_active(core->port) &&
    wl_packet_activity_pending(core->port));
}
wl_err_t usb_sample_pass(usb_sample_application_t *app, wl_endpoint_t *core, uint32_t now) {
  app->now = now;
  if (!app->output_pending && app->active && now - app->touched_at >= 1000) {
    app->active = false; ++app->aborts;
    wl_err_t error = status(app, app->transfer_id, CONTROL_BULK_PHASE_ABORT, CONTROL_BULK_STATUS_TIMED_OUT);
    if (error != WL_OK) return error;
  }
  wl_err_t error = flush(app, core);
  if (error != WL_OK) return error;
  /* Only this raw echo/object tool has this application gate. A pending output
   * applies pressure in route, independently of the kernel's RX/TX preference.
   * Three events allow completion, a blocked RX turn and TX submission without
   * consuming the only wake before the queued output can progress. No RPC is
   * registered, so this gate cannot suppress a client deadline. */
  if (!app->output_pending || tx_progress(app, core)) {
    error = wl_endpoint_step(core, now, 3U);
    if (error != WL_OK) return error;
  }
  return flush(app, core);
}
int usb_sample_ready(const usb_sample_application_t *app, const wl_endpoint_t *core, uint32_t now) {
  if (app->output_pending) return tx_progress(app, core);
  int has_deadline = 0; uint32_t deadline = 0;
  return wl_endpoint_ready(core, now, &has_deadline, &deadline);
}
uint32_t usb_sample_deadline(const usb_sample_application_t *app, uint32_t now) {
  if (!app->active || app->output_pending) return UINT32_MAX;
  uint32_t elapsed = now - app->touched_at;
  return elapsed >= 1000 ? 0 : 1000 - elapsed;
}
void usb_sample_close(usb_sample_application_t *app) {
  if (app->active) { app->active = false; ++app->aborts; }
  app->output_pending = false;
}
```

## src/application.h
```c
/* SPDX-License-Identifier: Apache-2.0 */
#ifndef WIRELINK_USB_SAMPLE_APPLICATION_H
#define WIRELINK_USB_SAMPLE_APPLICATION_H
#include "control.h"
#include "wirelink/endpoint.h"
#include <stdbool.h>
#define USB_SAMPLE_PAYLOAD_MAX 2048U
#define USB_SAMPLE_FRAME_MAX (USB_SAMPLE_PAYLOAD_MAX + 4U)
#define USB_SAMPLE_CHUNK_MAX 2016U
#define USB_SAMPLE_OBJECT_MAX (UINT64_C(64) * 1024 * 1024)

typedef struct {
  uint8_t pending[USB_SAMPLE_PAYLOAD_MAX];
  size_t pending_length;
  uint16_t pending_id;
  bool output_pending, active, report_pending;
  uint32_t now, transfer_id, expected_crc, crc, touched_at, started_at;
  uint32_t writes, commits, aborts, duplicates, chunk_size;
  uint64_t total, next;
  uint32_t completed_id, completed_crc, completed_writes, elapsed, report_due;
  uint64_t completed_length;
} usb_sample_application_t;
wl_err_t usb_sample_dispatch(usb_sample_application_t *, const wl_wire_frame_t *);
wl_err_t usb_sample_route(wl_endpoint_t *, const wl_wire_frame_t *);
wl_err_t usb_sample_pass(usb_sample_application_t *, wl_endpoint_t *, uint32_t now);
int usb_sample_ready(const usb_sample_application_t *, const wl_endpoint_t *, uint32_t now);
uint32_t usb_sample_deadline(const usb_sample_application_t *, uint32_t now);
void usb_sample_close(usb_sample_application_t *);
static inline uint32_t usb_sample_crc32c_update(uint32_t state, const uint8_t *data,
                                                size_t length) {
  for (size_t i = 0; i < length; ++i) {
    state ^= data[i];
    for (unsigned bit = 0; bit < 8U; ++bit)
      state = (state & 1U) ? ((state >> 1U) ^ UINT32_C(0x82F63B78)) : (state >> 1U);
  }
  return state;
}
static inline uint32_t usb_sample_crc32c(const uint8_t *data, size_t length) {
  return usb_sample_crc32c_update(UINT32_MAX, data, length) ^ UINT32_MAX;
}
#endif
```
