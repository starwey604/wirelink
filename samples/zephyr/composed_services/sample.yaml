## samples/zephyr/composed_services/sample.yaml
```yaml
sample:
  name: Static RPC telemetry bulk composition
tests:
  sample.wirelink.composed_services:
    tags: [wirelink, rpc, bulk]
    platform_allow: [native_sim, qemu_cortex_m3, qemu_riscv32, qemu_x86_64]
    integration_platforms: [native_sim]
    harness: console
    harness_config:
      type: one_line
      regex: ["COMPOSED_SERVICES PASS"]
```

## samples/zephyr/session/sample.yaml
```yaml
# SPDX-License-Identifier: Apache-2.0
sample:
  name: Wirelink automatic session and RPC ownership
tests:
  sample.wirelink.session:
    tags: [wirelink, wlc, rpc]
    platform_allow: [native_sim, qemu_cortex_m3, qemu_riscv32, qemu_x86_64]
    integration_platforms: [native_sim, qemu_cortex_m3]
    timeout: 60
    harness: console
    harness_config:
      type: one_line
      regex: ['SESSION_P0 ALL PASS']
```

## tests/zephyr/integration/bulk_transfer/testcase.yaml
```yaml
tests:
  wirelink.bulk_transfer.unit:
    type: unit
    tags:
      - wirelink
      - wlc
      - bulk
      - cobs
    timeout: 120
    platform_allow:
      - unit_testing
  wirelink.bulk_transfer.integration:
    tags:
      - wirelink
      - wlc
      - bulk
      - cobs
      - integration
    harness: ztest
    timeout: 120
    integration_platforms:
      - native_sim
      - qemu_cortex_m3
      - qemu_riscv32
      - qemu_x86_64
    platform_allow:
      - native_sim
      - qemu_cortex_m3
      - qemu_riscv32
      - qemu_x86_64
```

## tests/zephyr/integration/mixed_traffic/testcase.yaml
```yaml
tests:
  wirelink.mixed_traffic.integration:
    tags: [wirelink, rpc, latest, integration]
    harness: ztest
    integration_platforms: [native_sim, qemu_cortex_m3, qemu_riscv32]
    platform_allow: [native_sim, qemu_cortex_m3, qemu_riscv32]
```

## tests/zephyr/integration/protocol/testcase.yaml
```yaml
tests:
  wirelink.protocol.integration:
    tags:
      - wirelink
      - protocol
      - integration
    harness: ztest
    integration_platforms:
      - native_sim
      - qemu_cortex_m3
      - qemu_riscv32
      - qemu_x86_64
    platform_allow:
      - native_sim
      - qemu_cortex_m3
      - qemu_riscv32
      - qemu_x86_64
```

## tests/zephyr/integration/static_uart/testcase.yaml
```yaml
tests:
  wirelink.static_uart.integration:
    tags: [wirelink, uart, integration]
    harness: ztest
    integration_platforms: [native_sim, qemu_cortex_m3, qemu_riscv32]
    platform_allow: [native_sim, native_sim/native/64, qemu_cortex_m3, qemu_riscv32]
```

## tests/zephyr/integration/static_udp/testcase.yaml
```yaml
tests:
  wirelink.static_udp.integration:
    tags: [wirelink, udp, integration]
    harness: ztest
    integration_platforms: [native_sim]
    platform_allow: [native_sim, native_sim/native/64]
```

## tests/zephyr/integration/static_usb_bulk/testcase.yaml
```yaml
tests:
  wirelink.static_usb_bulk:
    tags: [wirelink, usb, kernel, integration]
    harness: ztest
    platform_allow: [native_sim]
    integration_platforms: [native_sim]
```

## tests/zephyr/integration/uart_irq_adapter/testcase.yaml
```yaml
tests:
  wirelink.uart_irq_adapter.timeout32:
    tags: [wirelink, uart, adapter]
    harness: ztest
    extra_configs:
      - CONFIG_TIMEOUT_64BIT=n
    platform_allow:
      - native_sim/native/64
  wirelink.uart_irq_adapter.smp:
    tags: [wirelink, uart, adapter, smp]
    harness: ztest
    extra_configs:
      - CONFIG_SMP=y
      - CONFIG_MP_MAX_NUM_CPUS=2
      - CONFIG_SCHED_CPU_MASK=y
    platform_allow:
      - qemu_x86_64
  wirelink.uart_irq_adapter.notifications:
    tags: [wirelink, uart, adapter]
    harness: ztest
    extra_configs:
      - CONFIG_WIRELINK_ZEPHYR_UART_IRQ_NOTIFICATION_DIAGNOSTICS=y
    platform_allow:
      - native_sim/native/64
  wirelink.uart_irq_adapter.timing:
    tags:
      - wirelink
      - uart
      - adapter
    harness: ztest
    extra_configs:
      - CONFIG_WIRELINK_ZEPHYR_UART_IRQ_TIMING=y
    platform_allow:
      - native_sim/native/64
  wirelink.uart_irq_adapter.integration:
    tags:
      - wirelink
      - uart
      - adapter
    harness: ztest
    integration_platforms:
      - native_sim/native/64
    platform_allow:
      - native_sim/native/64
```

## tests/zephyr/integration/uart_poll_adapter/testcase.yaml
```yaml
tests:
  wirelink.uart_poll_adapter.integration:
    tags: [wirelink, uart, adapter]
    harness: ztest
    platform_allow: [native_sim/native/64]
  wirelink.uart_poll_adapter.timeout32:
    tags: [wirelink, uart, adapter]
    harness: ztest
    extra_configs: [CONFIG_TIMEOUT_64BIT=n]
    platform_allow: [native_sim/native/64]
  wirelink.uart_poll_adapter.smp:
    tags: [wirelink, uart, adapter, smp]
    harness: ztest
    extra_configs: [CONFIG_SMP=y, CONFIG_MP_MAX_NUM_CPUS=2]
    platform_allow: [qemu_x86_64]
```

## tests/zephyr/integration/udp_adapter/testcase.yaml
```yaml
tests:
  wirelink.udp_adapter:
    tags: [wirelink, udp, socket, integration]
    harness: ztest
    platform_allow: [native_sim, native_sim/native/64, qemu_cortex_m3]
    integration_platforms: [native_sim/native/64, qemu_cortex_m3]
    timeout: 90
  wirelink.udp_adapter.timing:
    tags: [wirelink, udp, socket, integration]
    harness: ztest
    platform_allow: [native_sim, native_sim/native/64, qemu_cortex_m3]
    integration_platforms: [native_sim/native/64, qemu_cortex_m3]
    extra_configs: [CONFIG_WIRELINK_ZEPHYR_UDP_TIMING=y]
    timeout: 90
```

## tests/zephyr/integration/usb_bulk_adapter/testcase.yaml
```yaml
tests:
  wirelink.usb_bulk_adapter.native_error:
    tags: [wirelink, usb, integration]
    harness: ztest
    extra_args: [TEST_USB_NATIVE=ON, TEST_USB_NATIVE_ERROR=ON]
    platform_allow: [native_sim]
    integration_platforms: [native_sim]
  wirelink.usb_bulk_adapter.native:
    tags: [wirelink, usb, integration]
    harness: ztest
    extra_args: TEST_USB_NATIVE=ON
    platform_allow: [native_sim]
    integration_platforms: [native_sim]
  wirelink.usb_bulk_adapter.integration:
    tags:
      - wirelink
      - usb
      - integration
    harness: ztest
    integration_platforms:
      - native_sim
    platform_allow:
      - native_sim
```

## tests/zephyr/integration/usb_stream_rx/testcase.yaml
```yaml
tests:
  wirelink.usb_stream_rx:
    type: unit
    tags:
      - wirelink
      - usb
      - adapter
```

## tests/zephyr/integration/waiter/testcase.yaml
```yaml
tests:
  wirelink.waiter.timeout32:
    tags: [wirelink, rpc, integration]
    harness: ztest
    platform_allow: [native_sim/native/64]
    extra_configs:
      - CONFIG_TIMEOUT_64BIT=n
      - CONFIG_SYS_CLOCK_TICKS_PER_SEC=10000
  wirelink.waiter.integration:
    tags: [wirelink, rpc, integration]
    harness: ztest
    integration_platforms: [native_sim, native_sim/native/64, qemu_cortex_m3, qemu_riscv32, qemu_x86_64]
    platform_allow: [native_sim, native_sim/native/64, qemu_cortex_m3, qemu_riscv32, qemu_x86_64]
```

## tests/zephyr/unit/api_lifecycle/testcase.yaml
```yaml
tests:
  wirelink.api_lifecycle.unit:
    type: unit
    tags:
      - wirelink
      - api
```

## tests/zephyr/unit/bulk_receiver/testcase.yaml
```yaml
tests:
  wirelink.bulk_receiver.unit:
    type: unit
    tags:
      - wirelink
      - bulk
```

## tests/zephyr/unit/bulk_sender/testcase.yaml
```yaml
tests:
  wirelink.bulk_sender.unit:
    type: unit
    tags:
      - wirelink
      - bulk
      - sender
```

## tests/zephyr/unit/cobs/testcase.yaml
```yaml
tests:
  wirelink.cobs.unit:
    type: unit
    tags:
      - wirelink
      - cobs
```

## tests/zephyr/unit/endpoint_clock/testcase.yaml
```yaml
tests:
  wirelink.endpoint_clock.unit:
    type: unit
    tags:
      - wirelink
      - endpoint
      - clock
```

## tests/zephyr/unit/fifo/pthread/testcase.yaml
```yaml
tests:
  wirelink.fifo.pthread:
    type: unit
    tags:
      - wirelink
      - fifo
      - spsc
      - pthread
    timeout: 45
```

## tests/zephyr/unit/fifo/testcase.yaml
```yaml
tests:
  wirelink.fifo.unit:
    type: unit
    tags:
      - wirelink
      - fifo
      - spsc
```

## tests/zephyr/unit/frame/testcase.yaml
```yaml
tests:
  wirelink.frame.unit:
    type: unit
    tags:
      - wirelink
      - frame
```

## tests/zephyr/unit/framing_workload/testcase.yaml
```yaml
tests:
  wirelink.framing_workload.unit:
    type: unit
    tags: [wirelink, frame, protocol]
```

## tests/zephyr/unit/generated_codec/testcase.yaml
```yaml
tests:
  wirelink.generated_codec.current:
    type: unit
    tags:
      - wirelink
      - wlc
      - codec
    extra_args: WLC_SCHEMA_REVISION=current
  wirelink.generated_codec.previous:
    type: unit
    tags:
      - wirelink
      - wlc
      - codec
    extra_args: WLC_SCHEMA_REVISION=previous
```
