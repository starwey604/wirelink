## CMakeLists.txt
```
# SPDX-License-Identifier: Apache-2.0
cmake_minimum_required(VERSION 3.28.0)
set(WIRELINK_ROOT "${CMAKE_CURRENT_LIST_DIR}/../../..")
list(APPEND ZEPHYR_EXTRA_MODULES ${WIRELINK_ROOT})
find_package(Zephyr REQUIRED HINTS $ENV{ZEPHYR_BASE})
project(wirelink_udp_peer LANGUAGES C)
include(${WIRELINK_ROOT}/cmake/WirelinkWlc.cmake)
set(UDP_DEMO_SCHEMA "${WIRELINK_ROOT}/examples/05_zephyr_udp")
wirelink_wlc_generate(TARGET udp_demo_protocol SCHEMA "${UDP_DEMO_SCHEMA}/udp_demo.wl"
  PROFILE "${UDP_DEMO_SCHEMA}/udp_demo.bind.wl")
target_include_directories(app PRIVATE "${UDP_DEMO_SCHEMA}")
target_link_libraries(app PRIVATE udp_demo_protocol)
if(CONFIG_SAMPLE_WIRELINK_UDP_CLIENT)
  target_sources(app PRIVATE src/client.c)
else()
  target_sources(app PRIVATE src/server.c)
endif()
target_compile_options(app PRIVATE -Wall -Wextra -Werror)
```

## Kconfig
```
# SPDX-License-Identifier: Apache-2.0
mainmenu "Wirelink UDP peer"
source "Kconfig.zephyr"

choice SAMPLE_WIRELINK_UDP_ROLE
	prompt "Endpoint role"
	default SAMPLE_WIRELINK_UDP_SERVER
config SAMPLE_WIRELINK_UDP_SERVER
	bool "Server: Add RPC and 50 Hz telemetry"
config SAMPLE_WIRELINK_UDP_CLIENT
	bool "Client: Add RPC and telemetry receive"
endchoice

config SAMPLE_WIRELINK_UDP_PEER_ADDRESS
	string "Fixed numeric IPv4 peer address"
	default "192.0.2.1"

config SAMPLE_WIRELINK_UDP_LOCAL_PORT
	int "Local UDP port"
	range 1 65535
	default 49100 if SAMPLE_WIRELINK_UDP_CLIENT
	default 49101

config SAMPLE_WIRELINK_UDP_PEER_PORT
	int "Peer UDP port"
	range 1 65535
	default 49101 if SAMPLE_WIRELINK_UDP_CLIENT
	default 49100
```

## sample.yaml
```
# SPDX-License-Identifier: Apache-2.0
sample:
  name: Wirelink two-device UDP peer
  description: Separate client/server applications sharing the desktop peer schema
common:
  tags: [wirelink, wlc, udp]
  build_only: true
  platform_allow: [native_sim, native_sim/native/64]
  integration_platforms: [native_sim/native/64]
  extra_args: EXTRA_CONF_FILE=sim.conf
tests:
  sample.wirelink.udp_peer.server: {}
  sample.wirelink.udp_peer.client:
    extra_configs: [CONFIG_SAMPLE_WIRELINK_UDP_CLIENT=y]
```

## prj.conf
```kconfig
CONFIG_NETWORKING=y
CONFIG_NET_IPV4=y
CONFIG_NET_IPV6=n
CONFIG_NET_UDP=y
CONFIG_NET_TCP=n
CONFIG_NET_SOCKETS=y
CONFIG_NET_L2_ETHERNET=y
CONFIG_NET_CONFIG_SETTINGS=y
CONFIG_NET_CONFIG_AUTO_INIT=n
CONFIG_NET_CONFIG_MY_IPV4_ADDR="192.0.2.2"
CONFIG_NET_CONFIG_MY_IPV4_NETMASK="255.255.255.0"
CONFIG_NET_CONFIG_MY_IPV4_GW="192.0.2.1"
CONFIG_NET_PKT_TX_COUNT=16
CONFIG_NET_PKT_RX_COUNT=16
CONFIG_NET_BUF_TX_COUNT=32
CONFIG_NET_BUF_RX_COUNT=32
CONFIG_WIRELINK_PLATFORM=y
CONFIG_WIRELINK_ZEPHYR_UDP=y
CONFIG_MAIN_STACK_SIZE=4096
```

## client.conf
```kconfig
CONFIG_SAMPLE_WIRELINK_UDP_CLIENT=y
```

## sim.conf
```kconfig
# Simulation only. Never use this entropy source on a product board.
CONFIG_TEST_RANDOM_GENERATOR=y
```

## src/client.c
```c
/* SPDX-License-Identifier: Apache-2.0 */
#include "business.h"
#include "network.h"
#include <string.h>
static udp_demo_kernel_t client;
static sample_udp_t udp;
int main(void) {
  if (sample_network_init() < 0) { printk("network unavailable\n"); return 1; }
  wl_err_t error = sample_udp_open(&udp);
  if (error != WL_OK) { printk("UDP open: %d\n", error); return 1; }
  peer_client_t state = {0};
  const udp_demo_kernel_handlers_t handlers = {.on_rpc_add = peer_add, .on_message_telemetry = peer_sample};
  error = udp_demo_kernel_init(&client, &udp.port, &handlers, NULL, &state);
  if (error != WL_OK) { (void)wl_kernel_udp_close(&udp.adapter); return 1; }
  add_request_value_t request = {.has_left = true, .left = 20, .has_right = true, .right = 22};
  wl_kernel_call_handle_t call;
  error = udp_demo_kernel_add_start(&client, &request, k_uptime_get_32(), 1500, peer_completed, &state, &call);
  memset(&request, 0, sizeof(request));
  while (error == WL_OK && !state.completions) {
    error = peer_z_step(&udp.adapter, &client.core, k_uptime_get_32());
    if (error == WL_OK) error = peer_z_wait(&udp.adapter, &client.core, 100);
  }
  int status = 1;
  if (error == WL_OK && state.result.outcome == WL_KERNEL_SUCCESS) {
    printk("20 + 22 = %ld\n", (long)state.response.sum);
    uint32_t started = k_uptime_get_32();
    while (error == WL_OK && !state.samples && (uint32_t)(k_uptime_get_32() - started) < 500) {
      error = peer_z_step(&udp.adapter, &client.core, k_uptime_get_32());
      if (error == WL_OK) error = peer_z_wait(&udp.adapter, &client.core, 100);
    }
    if (state.samples && state.response.sum == 42) { printk("telemetry sample=%u\n", state.sample); status = 0; }
  } else printk("RPC: outcome=%d status=%d io=%d\n", state.result.outcome, state.result.status, error);
  if (peer_z_close(&udp.adapter, &client.core) != WL_OK) status = 1;
  return status;
}
```

## src/network.h
```c
/* SPDX-License-Identifier: Apache-2.0 */
#ifndef WIRELINK_SAMPLE_UDP_NETWORK_H_
#define WIRELINK_SAMPLE_UDP_NETWORK_H_
#include <zephyr/net/net_config.h>
#include <zephyr/net/socket.h>
#include <zephyr/sys/printk.h>
#include "wirelink/platform.h"
#include "zephyr_owner.h"
/* Board/PHY, IP configuration and a real fresh-instance source are application
 * provisioning. No adapter/core fallback or discovery is implied. */
typedef struct {
  wl_kernel_udp_t adapter;
  wl_packet_port_t port;
  uint8_t rx[2][2053];
} sample_udp_t;
static inline int sample_network_init(void) {
  return net_config_init("Wirelink UDP", NET_CONFIG_NEED_IPV4, 30000);
}
static inline wl_err_t sample_udp_open(sample_udp_t *udp) {
  wl_environment_t environment = wl_platform_environment(); uint64_t instance;
  wl_err_t error = wl_session_next(environment.session, 0, &instance);
  if (error != WL_OK) return error;
  wl_packet_config_t port = {.instance = instance, .rx_storage = &udp->rx[0][0],
    .rx_storage_size = sizeof(udp->rx), .rx_unit_size = sizeof(udp->rx[0]),
    .submit = wl_kernel_udp_submit, .notify = wl_kernel_udp_notify, .user = &udp->adapter};
  error = wl_packet_init(&udp->port, &port);
  if (error != WL_OK) return error;
  wl_kernel_udp_config_t config = {.port = &udp->port, .maximum_datagram_size = 2052,
    .service_budget = 8, .clock = environment.clock,
    .local = {.sin_family = NET_AF_INET, .sin_port = net_htons(CONFIG_SAMPLE_WIRELINK_UDP_LOCAL_PORT)},
    .peer = {.sin_family = NET_AF_INET, .sin_port = net_htons(CONFIG_SAMPLE_WIRELINK_UDP_PEER_PORT)}};
  if (net_addr_pton(NET_AF_INET, CONFIG_SAMPLE_WIRELINK_UDP_PEER_ADDRESS, &config.peer.sin_addr) != 0)
    return WL_ERR_INVALID_ARG;
  return wl_kernel_udp_open(&udp->adapter, &config);
}
#endif
```

## src/server.c
```c
/* SPDX-License-Identifier: Apache-2.0 */
#include "business.h"
#include "network.h"
static udp_demo_kernel_t server;
static sample_udp_t udp;
int main(void) {
  if (sample_network_init() < 0) { printk("network unavailable\n"); return 1; }
  wl_err_t error = sample_udp_open(&udp);
  if (error != WL_OK) { printk("UDP open: %d\n", error); return 1; }
  const udp_demo_kernel_handlers_t handlers = {.on_rpc_add = peer_add};
  error = udp_demo_kernel_init(&server, &udp.port, &handlers, NULL, NULL);
  if (error != WL_OK) { (void)wl_kernel_udp_close(&udp.adapter); return 1; }
  printk("UDP peer server ready on %s:%u\n", CONFIG_NET_CONFIG_MY_IPV4_ADDR, wl_kernel_udp_local_port(&udp.adapter));
  uint32_t sequence = 0, due = k_uptime_get_32();
  for (;;) {
    uint32_t now = k_uptime_get_32();
    error = peer_z_step(&udp.adapter, &server.core, now);
    if (error != WL_OK) break;
    if ((int32_t)(now - due) >= 0) {
      telemetry_value_t sample = {.has_sample = true, .sample = ++sequence};
      error = udp_demo_kernel_send_telemetry(&server, &sample);
      if (error != WL_OK && error != WL_ERR_WOULD_BLOCK) break;
      due = now + 20;
    }
    now = k_uptime_get_32();
    error = peer_z_wait(&udp.adapter, &server.core, (int32_t)(due - now) > 0 ? due - now : 0);
    if (error != WL_OK) break;
  }
  printk("UDP owner stopped: %d\n", error);
  int status = peer_z_close(&udp.adapter, &server.core) == WL_OK ? 0 : 1;
  return status;
}
```
