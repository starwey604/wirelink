## CMakeLists.txt
```
# SPDX-License-Identifier: Apache-2.0
cmake_minimum_required(VERSION 3.28.0)
set(WIRELINK_ROOT "${CMAKE_CURRENT_LIST_DIR}/../../..")
list(APPEND ZEPHYR_EXTRA_MODULES ${WIRELINK_ROOT})
find_package(Zephyr REQUIRED HINTS $ENV{ZEPHYR_BASE})
project(wirelink_udp_peer LANGUAGES C)
include(${WIRELINK_ROOT}/cmake/WirelinkWlc.cmake)
set(UDP_DEMO_SCHEMA "${WIRELINK_ROOT}/examples/05_zephyr_udp")
if(CONFIG_SAMPLE_WIRELINK_UDP_CLIENT)
  set(UDP_NODE udp_client)
else()
  set(UDP_NODE udp_server)
endif()
wirelink_wlc_generate(TARGET udp_demo_protocol SCHEMA "${UDP_DEMO_SCHEMA}/udp_demo.wl"
  NODE ${UDP_NODE})
target_include_directories(app PRIVATE "${UDP_DEMO_SCHEMA}")
target_link_libraries(app PRIVATE udp_demo_protocol)
if(CONFIG_SAMPLE_WIRELINK_UDP_CLIENT)
  target_sources(app PRIVATE src/client.c)
else()
  target_sources(app PRIVATE src/server.c)
endif()
target_compile_options(app PRIVATE -Wall -Wextra -Werror)
```

## Kconfig
```
# SPDX-License-Identifier: Apache-2.0
mainmenu "Wirelink UDP peer"
source "Kconfig.zephyr"

choice SAMPLE_WIRELINK_UDP_ROLE
	prompt "Endpoint role"
	default SAMPLE_WIRELINK_UDP_SERVER
config SAMPLE_WIRELINK_UDP_SERVER
	bool "Server: Add RPC and 50 Hz telemetry"
config SAMPLE_WIRELINK_UDP_CLIENT
	bool "Client: Add RPC and telemetry receive"
endchoice

config SAMPLE_WIRELINK_UDP_PEER_ADDRESS
	string "Fixed numeric IPv4 peer address"
	default "192.0.2.1"

config SAMPLE_WIRELINK_UDP_LOCAL_PORT
	int "Local UDP port"
	range 1 65535
	default 49100 if SAMPLE_WIRELINK_UDP_CLIENT
	default 49101

config SAMPLE_WIRELINK_UDP_PEER_PORT
	int "Peer UDP port"
	range 1 65535
	default 49101 if SAMPLE_WIRELINK_UDP_CLIENT
	default 49100
```

## sample.yaml
```
# SPDX-License-Identifier: Apache-2.0
sample:
  name: Wirelink two-device UDP peer
  description: Separate client/server applications sharing the desktop peer schema
common:
  tags: [wirelink, wlc, udp]
  build_only: true
  platform_allow: [native_sim, native_sim/native/64]
  integration_platforms: [native_sim/native/64]
  extra_args: EXTRA_CONF_FILE=sim.conf
tests:
  sample.wirelink.udp_peer.server: {}
  sample.wirelink.udp_peer.client:
    extra_configs: [CONFIG_SAMPLE_WIRELINK_UDP_CLIENT=y]
```

## prj.conf
```kconfig
CONFIG_NETWORKING=y
CONFIG_NET_IPV4=y
CONFIG_NET_IPV6=n
CONFIG_NET_UDP=y
CONFIG_NET_TCP=n
CONFIG_NET_SOCKETS=y
CONFIG_NET_L2_ETHERNET=y
CONFIG_NET_CONFIG_SETTINGS=y
CONFIG_NET_CONFIG_AUTO_INIT=n
CONFIG_NET_CONFIG_MY_IPV4_ADDR="192.0.2.2"
CONFIG_NET_CONFIG_MY_IPV4_NETMASK="255.255.255.0"
CONFIG_NET_CONFIG_MY_IPV4_GW="192.0.2.1"
CONFIG_NET_PKT_TX_COUNT=16
CONFIG_NET_PKT_RX_COUNT=16
CONFIG_NET_BUF_TX_COUNT=32
CONFIG_NET_BUF_RX_COUNT=32
CONFIG_CSPRNG_NEEDED=y
CONFIG_WIRELINK_PLATFORM=y
CONFIG_WIRELINK_ZEPHYR_UDP=y
CONFIG_MAIN_STACK_SIZE=4096
```

## client.conf
```kconfig
CONFIG_SAMPLE_WIRELINK_UDP_CLIENT=y
```

## sim.conf
```kconfig
# Simulation only. Never use this entropy source on a product board.
CONFIG_TEST_RANDOM_GENERATOR=y
```

## src/client.c
```c
/* SPDX-License-Identifier: Apache-2.0 */
#include "business.h"
#include "network.h"
#include <string.h>
static udp_client_node_t client;
static sample_udp_t udp;
void udp_client_on_telemetry(udp_client_node_t *self, const telemetry_t *sample) {
  peer_sample(self->node.user, sample);
}
int main(void) {
  if (sample_network_init() < 0) { printk("network unavailable\n"); return 1; }
  uint32_t instance;
  wl_err_t error = wl_session_next(wl_platform_environment().session, 0U, &instance);
  if (error != WL_OK) return 1;
  wl_zephyr_udp_config_t config;
  error = sample_udp_configure(&config);
  if (error == WL_OK)
    error = udp_client_bind_instance(&client, instance, wl_zephyr_udp_transport(&udp.adapter, &config));
  if (error != WL_OK) { printk("UDP open: %d\n", error); return 1; }
  peer_client_t state = {0};
  client.node.user = &state;
  add_request_t request = {.left = 20, .right = 22};
  wl_call_handle_t call;
  error = udp_client_call_add_ex(&client, &request, k_uptime_get_32(), 1500, peer_completed, &state, &call);
  memset(&request, 0, sizeof(request));
  while (error == WL_OK && !state.completions) {
    error = wl_node_step(&client.node, k_uptime_get_32());
    if (error == WL_OK) error = wl_node_wait(&client.node, k_uptime_get_32(), 100);
  }
  int status = 1;
  if (error == WL_OK && state.result.outcome == WL_RPC_SUCCESS) {
    printk("20 + 22 = %ld\n", (long)state.response.sum);
    uint32_t started = k_uptime_get_32();
    while (error == WL_OK && !state.samples && (uint32_t)(k_uptime_get_32() - started) < 500) {
      error = wl_node_step(&client.node, k_uptime_get_32());
      if (error == WL_OK) error = wl_node_wait(&client.node, k_uptime_get_32(), 100);
    }
    if (state.samples && state.response.sum == 42) { printk("telemetry sample=%u\n", state.sample); status = 0; }
  } else printk("RPC: outcome=%d status=%d io=%d\n", state.result.outcome, state.result.status, error);
  if (wl_node_close(&client.node, k_uptime_get_32()) != WL_OK) status = 1;
  return status;
}
```

## src/network.h
```c
/* SPDX-License-Identifier: Apache-2.0 */
#ifndef WIRELINK_SAMPLE_UDP_NETWORK_H_
#define WIRELINK_SAMPLE_UDP_NETWORK_H_
#include <zephyr/net/net_config.h>
#include <zephyr/net/socket.h>
#include <zephyr/sys/printk.h>
#include "wirelink/platform.h"
#include "wirelink/zephyr/udp.h"
/* Board/PHY, IP configuration and a real fresh-instance source are application
 * provisioning. No adapter/core fallback or discovery is implied. */
typedef struct {
  wl_zephyr_udp_t adapter;
} sample_udp_t;
static inline int sample_network_init(void) {
  return net_config_init("Wirelink UDP", NET_CONFIG_NEED_IPV4, 30000);
}
static inline wl_err_t sample_udp_configure(wl_zephyr_udp_config_t *config) {
  *config = (wl_zephyr_udp_config_t){.service_budget = 8, .clock = wl_platform_environment().clock,
    .local = {.sin_family = NET_AF_INET, .sin_port = net_htons(CONFIG_SAMPLE_WIRELINK_UDP_LOCAL_PORT)},
    .peer = {.sin_family = NET_AF_INET, .sin_port = net_htons(CONFIG_SAMPLE_WIRELINK_UDP_PEER_PORT)}};
  return net_addr_pton(NET_AF_INET, CONFIG_SAMPLE_WIRELINK_UDP_PEER_ADDRESS, &config->peer.sin_addr) == 0
      ? WL_OK : WL_ERR_INVALID_ARG;
}
#endif
```

## src/server.c
```c
/* SPDX-License-Identifier: Apache-2.0 */
#include "business.h"
#include "network.h"
static udp_server_node_t server;
static sample_udp_t udp;
int32_t udp_server_on_add(udp_server_node_t *self, const add_request_t *request, add_response_t *response) {
  return peer_add(self->node.user, request, response);
}
int main(void) {
  if (sample_network_init() < 0) { printk("network unavailable\n"); return 1; }
  uint32_t instance;
  wl_err_t error = wl_session_next(wl_platform_environment().session, 0U, &instance);
  if (error != WL_OK) return 1;
  wl_zephyr_udp_config_t config;
  error = sample_udp_configure(&config);
  if (error == WL_OK)
    error = udp_server_bind_instance(&server, instance, wl_zephyr_udp_transport(&udp.adapter, &config));
  if (error != WL_OK) { return 1; }
  printk("UDP peer server ready on %s:%u\n", CONFIG_NET_CONFIG_MY_IPV4_ADDR, wl_zephyr_udp_local_port(&udp.adapter));
  uint32_t sequence = 0, due = k_uptime_get_32();
  for (;;) {
    uint32_t now = k_uptime_get_32();
    error = wl_node_step(&server.node, now);
    if (error != WL_OK) break;
    if ((int32_t)(now - due) >= 0) {
      telemetry_t sample = {.sample = ++sequence};
      error = udp_server_send_telemetry(&server, &sample);
      if (error != WL_OK && error != WL_ERR_WOULD_BLOCK) break;
      due = now + 20;
    }
    now = k_uptime_get_32();
    error = wl_node_wait(&server.node, k_uptime_get_32(), (int32_t)(due - now) > 0 ? due - now : 0);
    if (error != WL_OK) break;
  }
  printk("UDP owner stopped: %d\n", error);
  int status = wl_node_close(&server.node, k_uptime_get_32()) == WL_OK ? 0 : 1;
  return status;
}
```
