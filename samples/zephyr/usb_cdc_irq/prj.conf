## CMakeLists.txt
```
# SPDX-License-Identifier: Apache-2.0

cmake_minimum_required(VERSION 3.28.0)

set(WIRELINK_ROOT "${CMAKE_CURRENT_LIST_DIR}/../../..")
list(APPEND ZEPHYR_EXTRA_MODULES ${WIRELINK_ROOT})

find_package(Zephyr REQUIRED HINTS $ENV{ZEPHYR_BASE})
project(wirelink_usb_cdc_irq)

include(${ZEPHYR_BASE}/samples/subsys/usb/common/common.cmake)
target_sources(app PRIVATE src/main.c)
```

## sample.yaml
```
# SPDX-License-Identifier: Apache-2.0

sample:
  name: Wirelink USB CDC IRQ capability probe
  description: Diagnose missing physical TX completion in the CDC ACM interrupt API
tests:
  sample.wirelink.usb_cdc_irq:
    build_only: true
    depends_on: usbd
    tags:
      - usb
      - serial
      - wirelink
    integration_platforms:
      - nrf52840dk/nrf52840
```

## prj.conf
```kconfig
# SPDX-License-Identifier: Apache-2.0

CONFIG_WIRELINK=y
CONFIG_WIRELINK_ZEPHYR_UART_IRQ=y

CONFIG_USB_DEVICE_STACK_NEXT=y
CONFIG_UDC_DWC2_DMA=n
CONFIG_SERIAL=y
CONFIG_UART_INTERRUPT_DRIVEN=y
CONFIG_UART_LINE_CTRL=y
CONFIG_CDC_ACM_SERIAL_INITIALIZE_AT_BOOT=n

CONFIG_SAMPLE_USBD_PID=0x574D
CONFIG_SAMPLE_USBD_PRODUCT="Wirelink CDC IRQ endpoint"
CONFIG_SAMPLE_USBD_SELF_POWERED=n

CONFIG_PRINTK=y
CONFIG_LOG=n
CONFIG_MAIN_STACK_SIZE=4096
CONFIG_HEAP_MEM_POOL_SIZE=0
```

## app.overlay
```dts
/* SPDX-License-Identifier: Apache-2.0 */

&zephyr_udc0 {
  cdc_acm_uart0: cdc_acm_uart0 {
    compatible = "zephyr,cdc-acm-uart";
    label = "Wirelink USB CDC ACM";
  };
};
```

## src/main.c
```c
/* SPDX-License-Identifier: Apache-2.0 */
#include <zephyr/device.h>
#include <zephyr/kernel.h>
#include <zephyr/sys/printk.h>
#include "wirelink/zephyr/kernel_uart_irq.h"

static wl_kernel_uart_irq_t adapter;
static wl_packet_port_t port;
static wl_packet_stream_t stream;
static wl_byte_fifo_t fifo;
static uint8_t rx[2][65], tx[80], staging[128];

int main(void) {
  const struct device *cdc = DEVICE_DT_GET_ONE(zephyr_cdc_acm_uart);
  if (!device_is_ready(cdc)) { printk("CDC device unavailable\n"); return 1; }
  /* Diagnostic only: no USB enumeration, physical RX or TX is started. This
   * fixed local identity never represents a communication instance on wire. */
  wl_packet_config_t packet = {.instance = 1, .rx_storage = &rx[0][0],
    .rx_unit_size = sizeof(rx[0]), .rx_storage_size = sizeof(rx),
    .submit = wl_packet_stream_cobs_crc16_submit, .notify = wl_packet_stream_notify,
    .user = &stream};
  if (wl_packet_init(&port, &packet) != WL_OK) return 1;
  if (wl_byte_fifo_init(&fifo, (wl_span_t){staging, sizeof(staging)}, NULL, NULL) != WL_OK) return 1;
  wl_packet_stream_config_t connector = {.port = &port, .tx_storage = {tx, sizeof(tx)},
    .maximum_frame_size = 64, .physical_submit = wl_kernel_uart_irq_submit,
    .notify = wl_kernel_uart_irq_notify, .user = &adapter};
  if (wl_packet_stream_cobs_crc16_init(&stream, &connector) != WL_OK) return 1;
  wl_kernel_uart_irq_config_t physical = {.uart = cdc, .port = &port,
    .fifo = &fifo, .stream = &stream};
  const int error = wl_kernel_uart_irq_init(&adapter, &physical);
  if (error == WL_ERR_NOT_SUPPORTED) {
    wl_packet_stop(&port);
    printk("CDC IRQ unsupported: driver lacks the required physical completion API\n");
    return 0;
  }
  if (error == WL_OK) {
    wl_kernel_uart_irq_stop(&adapter);
    printk("CDC IRQ API present: physical drain semantics still require qualification\n");
    return 0;
  }
  wl_packet_stop(&port);
  printk("CDC IRQ capability probe failed: %d\n", error); return 1;
}
```

## src/owner_wait.h
```c
/* SPDX-License-Identifier: Apache-2.0 */
#ifndef WIRELINK_SAMPLE_CDC_OWNER_WAIT_H
#define WIRELINK_SAMPLE_CDC_OWNER_WAIT_H

#include "wirelink/endpoint.h"

/* Sample-local owner policy after a bounded step, shared with its integration
 * tests. The endpoint owns the clock domain; the attached waiter owns blocking,
 * notification consumption and stop. This does not step or dispatch protocol events. */
static inline wl_err_t cdc_wait_for_activity(wl_endpoint_t *endpoint) {
  wl_time_ms_t queried_at, wait_now;
  wl_readiness_t hint;
  wl_err_t result = wl_endpoint_now(endpoint, &queried_at);
  if (result != WL_OK) return result;
  result = wl_endpoint_get_readiness_at(endpoint, queried_at, &hint);
  if (result != WL_OK) return result;
  const wl_waiter_t *waiter = wl_endpoint_waiter(endpoint);
  if (waiter == NULL) return WL_ERR_NOT_SUPPORTED;
  uint32_t remaining = hint.runnable ? 0U : hint.next_deadline_ms;
  if (remaining != 0U && remaining != WL_NO_DEADLINE) {
    result = wl_endpoint_now(endpoint, &wait_now);
    if (result != WL_OK) return result;
    remaining = wl_wait_remaining(remaining, queried_at, wait_now);
  }
  /* A zero-time wait also observes a stop during the query. Consume the latch
   * only in wait; the caller always performs the next step after a wake. */
  return waiter->wait(waiter->user_data, remaining);
}

#endif
```
