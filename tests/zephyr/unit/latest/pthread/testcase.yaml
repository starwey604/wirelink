## tests/zephyr/unit/latest/pthread/testcase.yaml
```yaml
tests:
  wirelink.latest.pthread:
    type: unit
    tags:
      - wirelink
      - latest
      - spsc
      - pthread
    timeout: 30
```

## tests/zephyr/unit/latest/unit/testcase.yaml
```yaml
tests:
  wirelink.latest.unit:
    type: unit
    tags:
      - wirelink
      - latest
      - spsc
```

## tests/zephyr/unit/link_profile/testcase.yaml
```yaml
tests:
  wirelink.link_profile.multi:
    type: unit
    extra_args:
      - WIRELINK_LINK_PROFILE=multi
    tags: [wirelink, frame, protocol]
  wirelink.link_profile.cobs_crc16:
    type: unit
    extra_args:
      - WIRELINK_LINK_PROFILE=cobs-crc16
    tags: [wirelink, frame, protocol]
```

## tests/zephyr/unit/protocol/testcase.yaml
```yaml
tests:
  wirelink.protocol.unit:
    type: unit
    tags:
      - wirelink
      - protocol
```

## tests/zephyr/unit/rpc/testcase.yaml
```yaml
tests:
  wirelink.rpc.unit:
    type: unit
    tags:
      - wirelink
      - rpc
```

## tests/zephyr/unit/rpc_async/testcase.yaml
```yaml
tests:
  wirelink.rpc_async.unit:
    type: unit
    tags:
      - wirelink
      - rpc
```

## tests/zephyr/unit/static_packet_port/testcase.yaml
```yaml
tests:
  wirelink.static_packet_port:
    type: unit
    tags: [wirelink, kernel, ownership]
```

## tests/zephyr/unit/static_stream/testcase.yaml
```yaml
tests:
  wirelink.static_stream:
    type: unit
    tags: [wirelink, framing, ownership]
```

## tests/zephyr/unit/usb_bulk_config/testcase.yaml
```yaml
tests:
  wirelink.usb_bulk_config.unit:
    type: unit
    tags: [wirelink, usb, config]
```

## west.yml
```yaml
# West manifest for a standalone Wirelink development workspace.
#
# Usage:
#   west init -m https://github.com/starwey604/wirelink <workspace>
#   cd <workspace>
#   west update
manifest:
  version: "1.2"

  remotes:
    - name: zephyrproject-rtos
      url-base: https://github.com/zephyrproject-rtos

  projects:
    - name: zephyr
      remote: zephyrproject-rtos
      revision: ca10f7fc7a5b5b1129823cfc57506e81bb109743
      import: true

  self:
    path: wirelink
```

## zephyr/Kconfig
```kconfig
# SPDX-License-Identifier: Apache-2.0
menu "Wirelink"
config WIRELINK
	bool "Enable the static Wirelink endpoint kernel"
	default y
	help
	  Portable C11 packet ownership and bounded four-call/four-reply execution.
	  Best-effort ordinary DATA only: no ARQ, ACK state, replay or deferred reply.
	  Select one wire connector in each version2 binding profile.
if WIRELINK
config WIRELINK_PLATFORM
	bool "Native clock and fresh-instance environment"
	select CSPRNG_NEEDED
	help
	  Initialization-only platform clock/session providers; no core clock reads.
config WIRELINK_PACKET_LOOPBACK
	bool "Single-owner in-process packet loopback"
config WIRELINK_PACKET_STREAM
	bool
config WIRELINK_FRAMING_PRIMITIVES
	bool "Independent COBS and CRC primitives"
config WIRELINK_STREAM_COBS_CRC16
	bool "COBS/CRC16 packet connector"
	select WIRELINK_PACKET_STREAM
	select WIRELINK_FRAMING_PRIMITIVES
config WIRELINK_STREAM_LENGTH16_NONE
	bool "Length16/NONE packet connector"
	select WIRELINK_PACKET_STREAM
config WIRELINK_BYTE_FIFO
	bool "Independent SPSC byte staging"
config WIRELINK_BYTE_FIFO_COBS
	bool
	select WIRELINK_BYTE_FIFO
	select WIRELINK_STREAM_COBS_CRC16
config WIRELINK_CONTAINERS
	bool "Independent FIFO, LATEST and outbox data tools"
config WIRELINK_FRAME_TOOLS
	bool "Standalone frozen-wire frame tools"
	select WIRELINK_FRAMING_PRIMITIVES
	help
	  Independent framing utilities include historical reliable/ACK wire formats.
	  This does not enable reliable execution in the endpoint kernel.
config WIRELINK_STORAGE
	bool "Independent caller-owned fixed-block allocator"
config WIRELINK_ZEPHYR_WAIT
	bool "Latched owner wait and stop notification"
	depends on MULTITHREADING
	help
	  Static semaphore, no internal thread, RPC table or protocol callback.
config WIRELINK_ZEPHYR_UART_DMA
	bool "Asynchronous UART packet adapter"
	depends on SERIAL && UART_ASYNC_API
	select WIRELINK_BYTE_FIFO_COBS
	help
	  Callbacks stage bytes only. Owner decodes COBS and drives the endpoint.
	  Stop waits for actual DMA buffer returns and callback quiescence.
config WIRELINK_ZEPHYR_USB_BULK
	bool "Native/NONE USB vendor bulk packet adapter"
	depends on USB_DEVICE_STACK_NEXT
	help
	  Two caller-owned RX units, one physical read/write, explicit boundary
	  faults and real cancellation acknowledgement; no protocol work in I/O.
config WIRELINK_ZEPHYR_UART_POLL_EXPERIMENTAL
	bool "Experimental physical UART polling packet adapter"
	depends on SERIAL && MULTITHREADING
	select WIRELINK_BYTE_FIFO_COBS
	help
	  Static RX worker stages bytes. Polling TX reports consumed, and a required
	  platform tx_idle callback confirms actual physical drain before reuse.
config WIRELINK_ZEPHYR_UART_IRQ
	bool "Interrupt-driven UART packet adapter"
	depends on SERIAL && UART_INTERRUPT_DRIVEN
	select WIRELINK_BYTE_FIFO_COBS
	help
	  ISR stages bytes; owner parses. TX completion requires irq_tx_complete.
	  No claim that accepting bytes proves the hardware has drained.
config WIRELINK_ZEPHYR_UART_IRQ_TIMING
	bool "UART callback timing diagnostics"
	depends on WIRELINK_ZEPHYR_UART_IRQ
config WIRELINK_ZEPHYR_UART_IRQ_NOTIFICATION_DIAGNOSTICS
	bool "UART notification diagnostics"
	depends on WIRELINK_ZEPHYR_UART_IRQ
config WIRELINK_ZEPHYR_UDP
	bool "Native IPv4 UDP packet adapter"
	depends on MULTITHREADING && NET_SOCKETS && NET_NATIVE_IPV4 && NET_NATIVE_UDP
	depends on !NET_SOCKETS_OFFLOAD
	select ZVFS_EVENTFD
	help
	  Owner-only sockets, fixed peer and latched eventfd waiting. Optional
	  selected transport decoder; no adapter thread or heap.
endif
endmenu
```
