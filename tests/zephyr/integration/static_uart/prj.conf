## CMakeLists.txt
```
# SPDX-License-Identifier: Apache-2.0
cmake_minimum_required(VERSION 3.20.0)
get_filename_component(WIRELINK_ROOT "${CMAKE_CURRENT_LIST_DIR}/../../../.." ABSOLUTE)
list(APPEND ZEPHYR_EXTRA_MODULES ${WIRELINK_ROOT})
find_package(Zephyr REQUIRED HINTS $ENV{ZEPHYR_BASE})
project(wirelink_static_uart)
target_sources(app PRIVATE src/irq.c src/dma.c src/poll.c)
```

## Kconfig
```
# SPDX-License-Identifier: Apache-2.0

mainmenu "Wirelink UART adapter integration test"

config WIRELINK_TEST_FAKE_UART_ASYNC
	def_bool y
	select SERIAL_SUPPORT_ASYNC
	select SERIAL_SUPPORT_INTERRUPT
	help
	  Expose the asynchronous UART API on platforms whose physical UART driver
	  does not implement it; this test supplies its own fake UART device.

source "Kconfig.zephyr"
```

## prj.conf
```kconfig
CONFIG_ZTEST=y
CONFIG_WIRELINK=y
CONFIG_SERIAL=y
CONFIG_UART_INTERRUPT_DRIVEN=y
CONFIG_UART_ASYNC_API=y
CONFIG_ASSERT=y
CONFIG_DEVICE_API_ASSERT=y
CONFIG_ZTEST_STACK_SIZE=4096
CONFIG_MAIN_STACK_SIZE=4096
CONFIG_WIRELINK_ZEPHYR_UART_DMA=y
CONFIG_WIRELINK_ZEPHYR_UART_IRQ=y
CONFIG_WIRELINK_ZEPHYR_UART_POLL_EXPERIMENTAL=y
```

## src/dma.c
```c
/* SPDX-License-Identifier: Apache-2.0 */

#include <errno.h>
#include <stdbool.h>
#include <stddef.h>
#include <stdint.h>
#include <string.h>

#include <zephyr/device.h>
#include <zephyr/drivers/uart.h>
#include <zephyr/sys/util.h>
#include <zephyr/ztest.h>

#include "wirelink/frame.h"
#include "wirelink/zephyr/kernel_uart_dma.h"

#define TEST_MAX_PAYLOAD 64U
#define TEST_STORAGE_SIZE 128U

struct fake_uart_data {
  uart_callback_t callback;
  void *callback_data;
  uint8_t *rx_buf;
  size_t rx_len;
  uint8_t *rx_next_buf;
  size_t rx_next_len;
  const uint8_t *tx_buf;
  size_t tx_len;
  int next_tx_result;
  bool rx_enabled;
  bool tx_active;
  bool tx_idle;
  size_t callback_sets;
  size_t rx_enables;
  size_t rx_buf_responses;
  size_t rx_disabled_events;
  size_t rx_disables;
  size_t tx_calls;
  size_t tx_aborts;
};

static struct fake_uart_data fake_data;
K_SEM_DEFINE(callback_detached, 0, 1);
K_SEM_DEFINE(callback_entered, 0, 1);
K_SEM_DEFINE(callback_continue, 0, 1);
K_SEM_DEFINE(quiesce_done, 0, 1);
K_THREAD_STACK_DEFINE(callback_stack, 2048);
K_THREAD_STACK_DEFINE(quiesce_stack, 2048);
static struct device_state fake_state = {
    .init_res = 0,
    .initialized = 1,
};

static int fake_callback_set(const struct device *dev, uart_callback_t callback, void *user_data) {
  struct fake_uart_data *data = dev->data;

  data->callback = callback;
  data->callback_data = user_data;
  data->callback_sets++;
  if (callback == NULL)
    k_sem_give(&callback_detached);
  return 0;
}

static int fake_tx(const struct device *dev, const uint8_t *buf, size_t len, int32_t timeout) {
  struct fake_uart_data *data = dev->data;
  int ret = data->next_tx_result;

  ARG_UNUSED(timeout);
  data->next_tx_result = 0;
  data->tx_calls++;
  if (ret != 0) {
    return ret;
  }
  if (data->tx_active) {
    return -EBUSY;
  }
  data->tx_buf = buf;
  data->tx_len = len;
  data->tx_active = true;
  data->tx_idle = false;
  return 0;
}

static int fake_irq_tx_complete(const struct device *dev) {
  struct fake_uart_data *data = dev->data;

  return data->tx_idle ? 1 : 0;
}

static int fake_tx_abort(const struct device *dev) {
  struct fake_uart_data *data = dev->data;

  data->tx_aborts++;
  return data->tx_active ? 0 : -EFAULT;
}

static int fake_rx_enable(const struct device *dev, uint8_t *buf, size_t len, int32_t timeout) {
  struct fake_uart_data *data = dev->data;
  struct uart_event event = {.type = UART_RX_BUF_REQUEST};

  ARG_UNUSED(timeout);
  if (data->rx_enabled) {
    return -EBUSY;
  }
  data->rx_buf = buf;
  data->rx_len = len;
  data->rx_enabled = true;
  data->rx_enables++;
  if (data->callback != NULL) {
    data->callback(dev, &event, data->callback_data);
  }
  return 0;
}

static int fake_rx_buf_rsp(const struct device *dev, uint8_t *buf, size_t len) {
  struct fake_uart_data *data = dev->data;

  if (!data->rx_enabled || data->rx_next_buf != NULL) {
    return -EBUSY;
  }
  data->rx_next_buf = buf;
  data->rx_next_len = len;
  data->rx_buf_responses++;
  return 0;
}

static int fake_rx_disable(const struct device *dev) {
  struct fake_uart_data *data = dev->data;

  data->rx_disables++;
  return data->rx_enabled ? 0 : -EFAULT;
}

static DEVICE_API(uart, fake_api) = {
    .callback_set = fake_callback_set,
    .tx = fake_tx,
    .tx_abort = fake_tx_abort,
    .irq_tx_complete = fake_irq_tx_complete,
    .rx_enable = fake_rx_enable,
    .rx_buf_rsp = fake_rx_buf_rsp,
    .rx_disable = fake_rx_disable,
};

static struct device fake_uart = {
    .api = &fake_api,
    .data = &fake_data,
    .state = &fake_state,
};

static wl_kernel_uart_dma_t adapter;
static wl_packet_port_t port;
static wl_packet_stream_t stream;
static wl_byte_fifo_t fifo;
static uint8_t rx[2][96], tx[96], bytes[128], dma[2][128];
static void emit(struct uart_event *event) {
  fake_data.callback(&fake_uart, event, fake_data.callback_data);
}
static uint64_t instance = 1000U;
static void setup(void) {
  memset(&fake_data, 0, sizeof(fake_data));
  zassert_ok(wl_byte_fifo_init(&fifo, (wl_span_t){bytes, sizeof(bytes)}, wl_kernel_uart_dma_notify,
                               &adapter));
  wl_packet_config_t pc = {.instance = ++instance,
                           .rx_storage = &rx[0][0],
                           .rx_unit_size = 96,
                           .rx_storage_size = sizeof(rx),
                           .submit = wl_packet_stream_cobs_crc16_submit,
                           .notify = wl_packet_stream_notify,
                           .user = &stream};
  zassert_ok(wl_packet_init(&port, &pc));
  wl_packet_stream_config_t sc = {.port = &port,
                                  .tx_storage = {tx, sizeof(tx)},
                                  .maximum_frame_size = 64,
                                  .physical_submit = wl_kernel_uart_dma_submit,
                                  .notify = wl_kernel_uart_dma_notify,
                                  .user = &adapter};
  zassert_ok(wl_packet_stream_cobs_crc16_init(&stream, &sc));
  wl_kernel_uart_dma_config_t config = {.uart = &fake_uart,
                                        .port = &port,
                                        .fifo = &fifo,
                                        .stream = &stream,
                                        .rx_buffers = {{dma[0], 128}, {dma[1], 128}},
                                        .timeout_us = 100,
                                        .tx_timeout_us = SYS_FOREVER_US,
                                        .wait_for_tx_idle = true};
  zassert_ok(wl_kernel_uart_dma_init(&adapter, &config));
  zassert_ok(wl_kernel_uart_dma_start(&adapter));
}
ZTEST(static_uart_dma, test_callbacks_stage_and_stop_requires_real_returns) {
  setup();
  uint8_t packet[12] = {0xa4, 0, 0, 22, 1, 2, 3, 4, 5, 6, 7, 8};
  wl_packet_token_t token;
  zassert_ok(wl_packet_tx_submit(&port, packet, sizeof(packet), &token));
  size_t length = fake_data.tx_len;
  memcpy(fake_data.rx_buf, fake_data.tx_buf, length);
  struct uart_event ready = {.type = UART_RX_RDY,
                             .data.rx = {.buf = fake_data.rx_buf, .offset = 0, .len = length}};
  emit(&ready);
  zassert_false(wl_packet_rx_ready(&port));
  zassert_ok(wl_kernel_uart_dma_service(&adapter, 0));
  wl_packet_borrow_t borrow;
  zassert_ok(wl_packet_rx_borrow(&port, &borrow));
  zassert_equal(borrow.length, sizeof(packet));
  zassert_mem_equal(borrow.data, packet, sizeof(packet));
  zassert_ok(wl_packet_rx_release(&port, &borrow));
  struct uart_event done = {.type = UART_TX_DONE,
                            .data.tx = {.buf = fake_data.tx_buf, .len = fake_data.tx_len}};
  fake_data.tx_active = false;
  emit(&done);
  zassert_ok(wl_kernel_uart_dma_service(&adapter, 0));
  zassert_equal(wl_packet_tx_take(&port, &token), WL_PACKET_CONSUMED);
  zassert_true(wl_packet_tx_active(&port));
  fake_data.tx_idle = true;
  zassert_ok(wl_kernel_uart_dma_service(&adapter, 1));
  zassert_equal(wl_packet_tx_take(&port, &token), WL_PACKET_DRAINED);
  zassert_ok(wl_packet_tx_submit(&port, packet, sizeof(packet), &token));
  zassert_ok(wl_kernel_uart_dma_stop(&adapter));
  zassert_equal(wl_kernel_uart_dma_service(&adapter, 2), WL_ERR_WOULD_BLOCK);
  // RX disable acknowledgement alone does not return the two DMA buffers.
  struct uart_event disabled = {.type = UART_RX_DISABLED};
  fake_data.rx_enabled = false;
  emit(&disabled);
  zassert_equal(wl_kernel_uart_dma_service(&adapter, 2), WL_ERR_WOULD_BLOCK);
  for (unsigned i = 0; i < 2; ++i) {
    struct uart_event released = {.type = UART_RX_BUF_RELEASED, .data.rx_buf = {.buf = dma[i]}};
    emit(&released);
  }
  zassert_equal(wl_kernel_uart_dma_service(&adapter, 2), WL_ERR_WOULD_BLOCK);
  struct uart_event aborted = {.type = UART_TX_ABORTED,
                               .data.tx = {.buf = fake_data.tx_buf, .len = 0}};
  fake_data.tx_active = false;
  emit(&aborted);
  zassert_ok(wl_kernel_uart_dma_service(&adapter, 2));
  zassert_true(wl_packet_tx_take(&port, &token) & WL_PACKET_TX_ERROR);
  uart_callback_t old = fake_data.callback;
  void *old_user = fake_data.callback_data;
  wl_kernel_uart_dma_quiesce(&adapter);
  zassert_true(wl_packet_quiescent(&port));
  old(&fake_uart, &ready, old_user);
  zassert_false(wl_byte_fifo_readable(&fifo));
}
static struct k_thread callback_thread, quiesce_thread;
static void suspend_callback(void *unused) {
  (void)unused;
  if (k_current_get() != &callback_thread)
    return;
  k_sem_give(&callback_entered);
  (void)k_sem_take(&callback_continue, K_FOREVER);
}
static void finish_callback(void *a, void *b, void *c) {
  (void)a;
  (void)b;
  (void)c;
  struct uart_event disabled = {.type = UART_RX_DISABLED};
  fake_data.rx_enabled = false;
  emit(&disabled);
}
static void close_adapter(void *a, void *b, void *c) {
  (void)a;
  (void)b;
  (void)c;
  wl_kernel_uart_dma_quiesce(&adapter);
  k_sem_give(&quiesce_done);
}
ZTEST(static_uart_dma, test_quiesce_joins_entered_callback_with_full_fifo) {
  setup();
  memset(dma[0], 77, sizeof(dma[0]));
  struct uart_event ready = {.type = UART_RX_RDY,
                             .data.rx = {.buf = dma[0], .offset = 0, .len = sizeof(dma[0])}};
  emit(&ready);
  zassert_false(wl_byte_fifo_has_space(&fifo));
  zassert_ok(wl_kernel_uart_dma_stop(&adapter));
  for (unsigned i = 0; i < 2; ++i) {
    struct uart_event released = {.type = UART_RX_BUF_RELEASED, .data.rx_buf = {.buf = dma[i]}};
    emit(&released);
  }
  k_sem_reset(&callback_detached);
  k_sem_reset(&callback_entered);
  k_sem_reset(&callback_continue);
  k_sem_reset(&quiesce_done);
  adapter.config.notify = suspend_callback;
  k_thread_create(&callback_thread, callback_stack, K_THREAD_STACK_SIZEOF(callback_stack),
                  finish_callback, NULL, NULL, NULL, 5, 0, K_NO_WAIT);
  zassert_ok(k_sem_take(&callback_entered, K_SECONDS(1)));
  k_thread_create(&quiesce_thread, quiesce_stack, K_THREAD_STACK_SIZEOF(quiesce_stack),
                  close_adapter, NULL, NULL, NULL, 5, 0, K_NO_WAIT);
  int detached = k_sem_take(&callback_detached, K_SECONDS(1));
  int early = k_sem_take(&quiesce_done, K_NO_WAIT);
  k_sem_give(&callback_continue);
  zassert_ok(detached);
  zassert_not_equal(early, 0);
  zassert_ok(k_sem_take(&quiesce_done, K_SECONDS(1)));
  zassert_ok(k_thread_join(&callback_thread, K_SECONDS(1)));
  zassert_ok(k_thread_join(&quiesce_thread, K_SECONDS(1)));
  zassert_true(adapter.detached);
  zassert_is_null(fake_data.callback);
  zassert_true(wl_packet_quiescent(&port));
  zassert_true(wl_byte_fifo_readable(&fifo)); // Unpublished bytes never block shutdown.
}
ZTEST_SUITE(static_uart_dma, NULL, NULL, NULL, NULL, NULL);
```

## src/irq.c
```c
/* SPDX-License-Identifier: Apache-2.0 */
#include <errno.h>
#include <string.h>
#include <zephyr/drivers/uart.h>
#include <zephyr/ztest.h>
#include "wirelink/frame.h"
#include "wirelink/kernel_wire.h"
#include "wirelink/kernel.h"
#include "wirelink/zephyr/kernel_uart_irq.h"

struct fake_uart {
  uart_irq_callback_user_data_t callback;
  void *user_data;
  uint8_t rx[128], tx[128];
  size_t rx_length, rx_offset, tx_length;
  bool rx_enabled, tx_enabled, pending, read_zero, fill_zero;
  int line_idle, error;
  unsigned reads, fills, complete_queries;
  size_t read_chunk;
  size_t fill_chunk;
  int read_error, fill_error;
  bool level_pending;
  void (*on_read)(void);
  void (*on_complete)(void);
};
static struct fake_uart full_data, cdc_data, missing_data, no_callback_data;

static int fake_init(const struct device *device) {
  (void)device;
  return 0;
}
static void fake_callback_set(const struct device *device, uart_irq_callback_user_data_t callback,
                              void *user_data) {
  struct fake_uart *data = device->data;
  data->callback = callback;
  data->user_data = user_data;
}
static void fake_rx_enable(const struct device *device) {
  ((struct fake_uart *)device->data)->rx_enabled = true;
}
static void fake_rx_disable(const struct device *device) {
  ((struct fake_uart *)device->data)->rx_enabled = false;
}
static void fake_tx_enable(const struct device *device) {
  ((struct fake_uart *)device->data)->tx_enabled = true;
}
static void fake_tx_disable(const struct device *device) {
  ((struct fake_uart *)device->data)->tx_enabled = false;
}
static int fake_rx_ready(const struct device *device) {
  struct fake_uart *data = device->data;
  return data->rx_enabled && data->rx_offset != data->rx_length;
}
static int fake_tx_ready(const struct device *device) {
  return ((struct fake_uart *)device->data)->tx_enabled;
}
static int fake_complete(const struct device *device) {
  struct fake_uart *data = device->data;
  ++data->complete_queries;
  if (data->on_complete != NULL)
    data->on_complete();
  return data->line_idle;
}
static int fake_error(const struct device *device) {
  struct fake_uart *data = device->data;
  int error = data->error;
  data->error = 0;
  return error;
}
static void fake_update(const struct device *device) { (void)device; }
static int fake_pending(const struct device *device) {
  struct fake_uart *data = device->data;
  bool pending = data->pending;
  data->pending = false;
  return pending || (data->level_pending && (fake_rx_ready(device) || fake_tx_ready(device)));
}
static int fake_read(const struct device *device, uint8_t *out, int capacity) {
  struct fake_uart *data = device->data;
  ++data->reads;
  if (data->on_read != NULL)
    data->on_read();
  if (data->read_error)
    return data->read_error;
  if (data->read_zero)
    return 0;
  size_t size = MIN((size_t)capacity, data->rx_length - data->rx_offset);
  if (data->read_chunk != 0U)
    size = MIN(size, data->read_chunk);
  memcpy(out, data->rx + data->rx_offset, size);
  data->rx_offset += size;
  return (int)size;
}
static int fake_fill(const struct device *device, const uint8_t *input, int length) {
  struct fake_uart *data = device->data;
  ++data->fills;
  if (data->fill_error)
    return data->fill_error;
  if (data->fill_zero)
    return 0;
  if (data->fill_chunk != 0U)
    length = MIN((size_t)length, data->fill_chunk);
  zassert_true(data->tx_length + (size_t)length <= sizeof(data->tx));
  memcpy(data->tx + data->tx_length, input, (size_t)length);
  data->tx_length += (size_t)length;
  return length;
}
#define COMMON_API                                                                                 \
  .irq_callback_set = fake_callback_set, .irq_rx_enable = fake_rx_enable,                          \
  .irq_rx_disable = fake_rx_disable, .irq_tx_enable = fake_tx_enable,                              \
  .irq_tx_disable = fake_tx_disable, .irq_rx_ready = fake_rx_ready, .irq_tx_ready = fake_tx_ready, \
  .irq_update = fake_update, .irq_is_pending = fake_pending

static DEVICE_API(uart, full_api) = {
    COMMON_API,
    .fifo_read = fake_read,
    .fifo_fill = fake_fill,
    .irq_tx_complete = fake_complete,
    .err_check = fake_error,
};
static DEVICE_API(uart, cdc_api) = {
    COMMON_API,
    .fifo_read = fake_read,
    .fifo_fill = fake_fill,
};
static DEVICE_API(uart, missing_api) = {COMMON_API, .irq_tx_complete = fake_complete};
static DEVICE_API(uart, no_callback_api) = {.irq_update = fake_update};
DEVICE_DEFINE(fake_uart_full, "fake_uart_full", fake_init, NULL, &full_data, NULL, POST_KERNEL,
              CONFIG_KERNEL_INIT_PRIORITY_DEFAULT, &full_api);
DEVICE_DEFINE(fake_uart_cdc, "fake_uart_cdc", fake_init, NULL, &cdc_data, NULL, POST_KERNEL,
              CONFIG_KERNEL_INIT_PRIORITY_DEFAULT, &cdc_api);
DEVICE_DEFINE(fake_uart_missing, "fake_uart_missing", fake_init, NULL, &missing_data, NULL,
              POST_KERNEL, CONFIG_KERNEL_INIT_PRIORITY_DEFAULT, &missing_api);
DEVICE_DEFINE(fake_uart_no_callback, "fake_uart_no_callback", fake_init, NULL, &no_callback_data,
              NULL, POST_KERNEL, CONFIG_KERNEL_INIT_PRIORITY_DEFAULT, &no_callback_api);

static wl_kernel_uart_irq_t adapter;
static wl_packet_port_t port;
static wl_packet_stream_t stream;
static wl_byte_fifo_t fifo;
static uint8_t rx[2][96], tx[96], bytes[16];
static uint64_t instance;
static void setup_interval(uint32_t interval) {
  memset(&full_data, 0, sizeof(full_data));
  full_data.line_idle = 1;
  zassert_ok(wl_byte_fifo_init(&fifo, (wl_span_t){bytes, sizeof(bytes)}, wl_kernel_uart_irq_notify,
                               &adapter));
  wl_packet_config_t pc = {.instance = ++instance,
                           .rx_storage = &rx[0][0],
                           .rx_unit_size = 96,
                           .rx_storage_size = sizeof(rx),
                           .submit = wl_packet_stream_cobs_crc16_submit,
                           .notify = wl_packet_stream_notify,
                           .user = &stream};
  zassert_ok(wl_packet_init(&port, &pc));
  wl_packet_stream_config_t sc = {.port = &port,
                                  .tx_storage = {tx, sizeof(tx)},
                                  .maximum_frame_size = 64,
                                  .physical_submit = wl_kernel_uart_irq_submit,
                                  .notify = wl_kernel_uart_irq_notify,
                                  .user = &adapter};
  zassert_ok(wl_packet_stream_cobs_crc16_init(&stream, &sc));
  wl_kernel_uart_irq_config_t config = {
      .uart = DEVICE_GET(fake_uart_full), .port = &port, .fifo = &fifo, .stream = &stream, .drain_check_ms = interval};
  zassert_ok(wl_kernel_uart_irq_init(&adapter, &config));
  zassert_ok(wl_kernel_uart_irq_start(&adapter));
}
static void setup(void) { setup_interval(0); }
static void fire(void) {
  full_data.pending = true;
  full_data.callback(DEVICE_GET(fake_uart_full), full_data.user_data);
}
ZTEST(static_uart_irq, test_staged_rx_physical_tx_and_old_callback) {
  setup();
  uint8_t packet[41];
  memset(packet + 4, 55, 37);
  zassert_ok(wl_kernel_native_none_seal(packet, sizeof(packet), 22, 37));
  wl_packet_token_t token;
  zassert_ok(wl_packet_tx_submit(&port, packet, sizeof(packet), &token));
  full_data.line_idle = 0;
  fire();
  zassert_ok(wl_kernel_uart_irq_service(&adapter, 0));
  zassert_equal(wl_packet_tx_take(&port, &token), WL_PACKET_CONSUMED);
  zassert_true(wl_packet_tx_active(&port));
  zassert_false(full_data.tx_enabled);
  full_data.line_idle = 1;
  zassert_ok(wl_kernel_uart_irq_service(&adapter, 1));
  zassert_equal(wl_packet_tx_take(&port, &token), WL_PACKET_DRAINED);
  memcpy(full_data.rx, full_data.tx, full_data.tx_length);
  full_data.rx_length = full_data.tx_length;
  fire();
  zassert_false(wl_packet_rx_ready(&port)); // IRQ staged bytes, no framing/parser.
  for (unsigned i = 0; i < 20 && !wl_packet_rx_ready(&port); ++i) {
    zassert_ok(wl_kernel_uart_irq_service(&adapter, i + 2));
    fire();
  }
  zassert_ok(wl_kernel_uart_irq_service(&adapter, 24));
  wl_packet_borrow_t borrow;
  zassert_ok(wl_packet_rx_borrow(&port, &borrow));
  zassert_equal(borrow.length, sizeof(packet));
  zassert_mem_equal(borrow.data, packet, sizeof(packet));
  zassert_ok(wl_packet_rx_release(&port, &borrow));
  uart_irq_callback_user_data_t old = full_data.callback;
  void *old_user = full_data.user_data;
  wl_kernel_uart_irq_stop(&adapter);
  zassert_true(wl_packet_quiescent(&port));
  setup();
  old(DEVICE_GET(fake_uart_full), old_user);
  zassert_false(wl_byte_fifo_readable(&fifo));
  wl_kernel_uart_irq_stop(&adapter);
  zassert_true(wl_packet_quiescent(&port));
}
ZTEST(static_uart_irq, test_rejects_cdc_without_physical_completion) {
  setup();
  wl_kernel_uart_irq_stop(&adapter);
  wl_kernel_uart_irq_config_t config = {.uart = DEVICE_GET(fake_uart_cdc),
    .port = &port, .fifo = &fifo, .stream = &stream};
  zassert_equal(wl_kernel_uart_irq_init(&adapter, &config), WL_ERR_NOT_SUPPORTED);
  zassert_is_null(cdc_data.callback);
  config.uart = DEVICE_GET(fake_uart_missing);
  zassert_equal(wl_kernel_uart_irq_init(&adapter, &config), WL_ERR_NOT_SUPPORTED);
  config.uart = DEVICE_GET(fake_uart_no_callback);
  zassert_equal(wl_kernel_uart_irq_init(&adapter, &config), WL_ERR_NOT_SUPPORTED);
  /* Failed admission cannot consume a binding or prevent a later real UART. */
  setup();
  wl_kernel_uart_irq_stop(&adapter);
}
static uint8_t short_packet[8];
static wl_packet_token_t pending_tx(uint32_t now) {
  memset(short_packet, 0, sizeof(short_packet));
  zassert_ok(wl_kernel_native_none_seal(short_packet, sizeof(short_packet), 22, 4));
  wl_packet_token_t token;
  zassert_ok(wl_packet_tx_submit(&port, short_packet, sizeof(short_packet), &token));
  full_data.line_idle = 0;
  fire();
  zassert_ok(wl_kernel_uart_irq_service(&adapter, now));
  zassert_equal(wl_packet_tx_take(&port, &token), WL_PACKET_CONSUMED);
  zassert_equal(full_data.complete_queries, 1);
  return token;
}
static void receive_byte(uint8_t byte) {
  zassert_true(full_data.rx_length < sizeof(full_data.rx));
  full_data.rx[full_data.rx_length++] = byte;
  fire();
}
static void finish_pending(wl_packet_token_t *token) {
  wl_kernel_uart_irq_stop(&adapter);
  (void)wl_packet_tx_take(&port, token);
  zassert_true(wl_packet_quiescent(&port));
}
ZTEST(static_uart_irq, test_no_progress_no_poll_and_notify_is_not_hint) {
  setup_interval(5);
  wl_packet_token_t token = pending_tx(10);
  zassert_equal(adapter.drain_due, 15);
  for (unsigned i = 0; i < 8; ++i) {
    wl_kernel_uart_irq_notify(&adapter);
    zassert_ok(wl_kernel_uart_irq_service(&adapter, 10));
  }
  zassert_equal(full_data.complete_queries, 1);
  /* IRQ read zero must not authorize a query. */
  full_data.read_zero = true;
  receive_byte(2);
  zassert_ok(wl_kernel_uart_irq_service(&adapter, 10));
  zassert_equal(full_data.complete_queries, 1);
  /* Full FIFO containing old delimiters: pause/resume is not RX progress. */
  wl_span_t room;
  zassert_ok(wl_byte_fifo_reserve(&fifo, &room));
  memset(room.data, 0, room.length);
  zassert_ok(wl_byte_fifo_commit(&fifo, room.length));
  full_data.read_zero = false;
  fire();
  zassert_ok(wl_kernel_uart_irq_service(&adapter, 10));
  zassert_equal(full_data.complete_queries, 1);
  zassert_equal(adapter.drain_due, 15);
  zassert_ok(wl_kernel_uart_irq_service(&adapter, 15));
  zassert_equal(full_data.complete_queries, 2);
  zassert_equal(adapter.drain_due, 20);
  finish_pending(&token);
}
static unsigned tail_notifications, early_notifications;
static void observe_tail(void *unused) { (void)unused; ++tail_notifications; }
static void consume_early_fifo_wake(void *context) {
  ++early_notifications;
  wl_kernel_uart_irq_notify(context);
  zassert_ok(wl_kernel_uart_irq_wait(context, K_NO_WAIT));
}
ZTEST(static_uart_irq, test_callback_tail_wake_survives_early_fifo_ack) {
  setup();
  tail_notifications = early_notifications = 0;
  adapter.notify = observe_tail;
  fifo.notify = consume_early_fifo_wake;
  for (unsigned i = 0; i < 2; ++i) {
    receive_byte(0); /* Each callback tail must still give. */
    zassert_equal(tail_notifications, i + 1);
    zassert_equal(early_notifications, i + 1);
    zassert_ok(wl_kernel_uart_irq_wait(&adapter, K_NO_WAIT));
    zassert_equal(wl_kernel_uart_irq_wait(&adapter, K_NO_WAIT), WL_ERR_NO_DATA);
  }
  zassert_ok(wl_kernel_uart_irq_service(&adapter, 0));
  zassert_equal(full_data.complete_queries, 0);
  wl_kernel_uart_irq_stop(&adapter);
}
ZTEST(static_uart_irq, test_failed_rx_and_large_interval_wrap) {
  setup(); wl_packet_token_t token = pending_tx(0);
  full_data.read_error = -EIO;
  receive_byte(0);
  zassert_equal(wl_kernel_uart_irq_service(&adapter, 0), WL_ERR_IO);
  zassert_equal(full_data.complete_queries, 1);
  finish_pending(&token);
  setup_interval(1000); token = pending_tx(UINT32_MAX - 10U);
  zassert_equal(adapter.drain_due, 989);
  zassert_ok(wl_kernel_uart_irq_service(&adapter, 0));
  zassert_equal(full_data.complete_queries, 1);
  full_data.line_idle = 1;
  zassert_ok(wl_kernel_uart_irq_service(&adapter, 988));
  zassert_equal(full_data.complete_queries, 1);
  zassert_ok(wl_kernel_uart_irq_service(&adapter, 989));
  zassert_equal(full_data.complete_queries, 2);
  zassert_equal(wl_packet_tx_take(&port, &token), WL_PACKET_DRAINED);
  wl_kernel_uart_irq_stop(&adapter);
}
static wl_err_t encode_four(const void *v, uint8_t *out, size_t capacity, size_t *size) {
  if (capacity < 4) return WL_ERR_BUF_TOO_SMALL;
  memcpy(out, v, 4); *size = 4; return WL_OK;
}
static wl_err_t unused_route(wl_kernel_t *k, const wl_kernel_frame_t *f) {
  (void)k; (void)f; return WL_OK;
}
static void unused_callback(void) {}
static void completed_call(wl_kernel_t *k, const wl_kernel_call_t *c, wl_kernel_result_t r,
                           const uint8_t *p, size_t n) {
  (void)k; (void)c; (void)r; (void)p; (void)n;
}
ZTEST(static_uart_irq, test_kernel_queued_frame_waits_for_real_drain) {
  setup();
  wl_kernel_t core;
  uint8_t snapshots[WL_KERNEL_TX_COUNT][32], value[4] = {1, 2, 3, 4};
  wl_kernel_config_t config = {.port = &port, .route = unused_route};
  for (unsigned i = 0; i < WL_KERNEL_TX_COUNT; ++i)
    config.tx_storage[i] = (wl_span_t){snapshots[i], sizeof(snapshots[i])};
  zassert_ok(wl_kernel_init(&core, &config));
  zassert_ok(wl_kernel_send(&core, 22, value, encode_four));
  zassert_ok(wl_kernel_step(&core, 0, 16));
  full_data.line_idle = 0; fire();
  zassert_ok(wl_kernel_uart_irq_service(&adapter, 0));
  zassert_ok(wl_kernel_step(&core, 0, 16)); /* Consumes CONSUMED, not DRAINED. */
  wl_kernel_call_handle_t h;
  zassert_ok(wl_kernel_call_start(&core, 23, 24, value, encode_four, 0, 2000,
    completed_call, unused_callback, NULL, &h));
  zassert_ok(wl_kernel_step(&core, 0, 16));
  zassert_equal(port.tx_sequence, 1);
  full_data.line_idle = 1; /* No new RX: both policies must retain fallback. */
  zassert_ok(wl_kernel_uart_irq_service(&adapter, 0));
  zassert_equal(port.tx_sequence, 1); /* Port is active until core takes DRAINED. */
  zassert_ok(wl_kernel_step(&core, 0, 16));
  zassert_equal(port.tx_sequence, 1);
  zassert_ok(wl_kernel_uart_irq_service(&adapter, 1));
  zassert_ok(wl_kernel_step(&core, 1, 16));
  zassert_equal(port.tx_sequence, 2);
  fire(); zassert_ok(wl_kernel_uart_irq_service(&adapter, 1));
  zassert_ok(wl_kernel_step(&core, 1, 16));
  zassert_ok(wl_kernel_close(&core));
  wl_kernel_uart_irq_stop(&adapter);
  zassert_ok(wl_kernel_step(&core, 1, 16));
  zassert_true(wl_kernel_quiescent(&core));
  zassert_true(wl_packet_quiescent(&port));
}
ZTEST_SUITE(static_uart_irq, NULL, NULL, NULL, NULL, NULL);
```

## src/poll.c
```c
/* SPDX-License-Identifier: Apache-2.0 */
#include "wirelink/zephyr/kernel_uart_poll.h"
#include <zephyr/drivers/uart.h>
#include <zephyr/ztest.h>
#include <string.h>
static wl_kernel_uart_poll_t adapter;
static wl_packet_port_t port;
static wl_packet_stream_t stream;
static wl_byte_fifo_t fifo;
static uint8_t rx[2][96], wire[96], staging[16], input[128], output[128];
static size_t input_length, input_offset, output_length;
static struct k_spinlock lock;
static atomic_t idle;
K_THREAD_STACK_DEFINE(stack, 2048);
static int initialize(const struct device *d) {
  (void)d;
  return 0;
}
static int read_byte(const struct device *d, unsigned char *out) {
  (void)d;
  k_spinlock_key_t key = k_spin_lock(&lock);
  int result = input_offset < input_length ? 0 : -1;
  if (!result)
    *out = input[input_offset++];
  k_spin_unlock(&lock, key);
  return result;
}
static void write_byte(const struct device *d, unsigned char byte) {
  (void)d;
  zassert_true(output_length < sizeof(output));
  output[output_length++] = byte;
}
static int line_idle(const struct device *d) {
  (void)d;
  return atomic_get(&idle);
}
static DEVICE_API(uart, poll_api) = {.poll_in = read_byte, .poll_out = write_byte};
DEVICE_DEFINE(packet_poll_uart, "packet_poll_uart", initialize, NULL, NULL, NULL, POST_KERNEL,
              CONFIG_KERNEL_INIT_PRIORITY_DEFAULT, &poll_api);
ZTEST(static_uart_poll, test_worker_stages_and_stop_waits_for_physical_idle) {
  zassert_ok(wl_byte_fifo_init(&fifo, (wl_span_t){staging, sizeof(staging)},
                               wl_kernel_uart_poll_notify, &adapter));
  wl_packet_config_t pc = {.instance = 3001,
                           .rx_storage = &rx[0][0],
                           .rx_unit_size = 96,
                           .rx_storage_size = sizeof(rx),
                           .submit = wl_packet_stream_cobs_crc16_submit,
                           .notify = wl_packet_stream_notify,
                           .user = &stream};
  zassert_ok(wl_packet_init(&port, &pc));
  wl_packet_stream_config_t sc = {.port = &port,
                                  .tx_storage = {wire, sizeof(wire)},
                                  .maximum_frame_size = 64,
                                  .physical_submit = wl_kernel_uart_poll_submit,
                                  .notify = wl_kernel_uart_poll_notify,
                                  .user = &adapter};
  zassert_ok(wl_packet_stream_cobs_crc16_init(&stream, &sc));
  wl_kernel_uart_poll_config_t config = {.uart = DEVICE_GET(packet_poll_uart),
                                         .port = &port,
                                         .fifo = &fifo,
                                         .stream = &stream,
                                         .stack = stack,
                                         .stack_size = K_THREAD_STACK_SIZEOF(stack),
                                         .priority = -1,
                                         .tx_idle = line_idle};
  zassert_ok(wl_kernel_uart_poll_init(&adapter, &config));
  zassert_ok(wl_kernel_uart_poll_start(&adapter));
  uint8_t packet[41] = {0xa4, 0, 0, 22};
  memset(packet + 4, 77, 37);
  wl_packet_token_t token;
  zassert_ok(wl_packet_tx_submit(&port, packet, sizeof(packet), &token));
  zassert_equal(wl_packet_tx_take(&port, &token), WL_PACKET_CONSUMED);
  zassert_true(wl_packet_tx_active(&port));
  k_spinlock_key_t key = k_spin_lock(&lock);
  memcpy(input, output, output_length);
  input_length = output_length;
  k_spin_unlock(&lock, key);
  k_sleep(K_TICKS(2));
  zassert_false(wl_packet_rx_ready(&port));
  for (unsigned i = 0; i < 100 && !wl_packet_rx_ready(&port); ++i) {
    zassert_ok(wl_kernel_uart_poll_service(&adapter, k_uptime_get_32()));
    k_sleep(K_TICKS(1));
  }
  wl_packet_borrow_t borrow;
  zassert_ok(wl_packet_rx_borrow(&port, &borrow));
  zassert_equal(borrow.length, sizeof(packet));
  zassert_mem_equal(borrow.data, packet, sizeof(packet));
  zassert_ok(wl_packet_rx_release(&port, &borrow));
  zassert_equal(wl_kernel_uart_poll_stop(&adapter), WL_ERR_WOULD_BLOCK);
  zassert_false(adapter.worker_created);
  zassert_false(wl_packet_quiescent(&port));
  atomic_set(&idle, 1);
  zassert_ok(wl_kernel_uart_poll_stop(&adapter));
  zassert_equal(wl_packet_tx_take(&port, &token), WL_PACKET_DRAINED);
  zassert_true(wl_packet_quiescent(&port));
  zassert_equal(wl_kernel_uart_poll_wait(&adapter, K_NO_WAIT), WL_ERR_CANCELLED);
}
ZTEST_SUITE(static_uart_poll, NULL, NULL, NULL, NULL, NULL);
```
