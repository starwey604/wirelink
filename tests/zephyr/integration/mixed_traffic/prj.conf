## CMakeLists.txt
```
# SPDX-License-Identifier: Apache-2.0
cmake_minimum_required(VERSION 3.21)
set(WIRELINK_ROOT "${CMAKE_CURRENT_LIST_DIR}/../../../..")
list(APPEND ZEPHYR_EXTRA_MODULES "${WIRELINK_ROOT}")
find_package(Zephyr REQUIRED HINTS $ENV{ZEPHYR_BASE})
project(wirelink_mixed_traffic_integration)
list(APPEND CMAKE_MODULE_PATH "${WIRELINK_ROOT}/cmake")
include(WirelinkWlc)
set(WORKLOAD "${WIRELINK_ROOT}/benchmarks/mixed_traffic")
wirelink_wlc_generate(TARGET mixed_protocol SCHEMA "${WORKLOAD}/mixed.wl"
  PROFILE "${WORKLOAD}/mixed.bind.wl")
target_sources(app PRIVATE src/main.c "${WORKLOAD}/workload.c")
target_include_directories(app PRIVATE "${WORKLOAD}")
target_link_libraries(app PRIVATE mixed_protocol)
target_compile_features(app PRIVATE c_std_11)
```

## prj.conf
```kconfig
CONFIG_ZTEST=y
CONFIG_MAIN_STACK_SIZE=8192
CONFIG_ZTEST_STACK_SIZE=8192
CONFIG_CBPRINTF_FP_SUPPORT=y

CONFIG_WIRELINK_STREAM_COBS_CRC16=y
CONFIG_WIRELINK_STREAM_LENGTH16_NONE=y
```

## src/main.c
```c
/* SPDX-License-Identifier: Apache-2.0 */
#include <zephyr/ztest.h>
#include "workload.h"

ZTEST(wirelink_mixed_traffic, test_freshness_and_rpc_progress) {
  zassert_ok(mixed_traffic_run(true));
}
ZTEST_SUITE(wirelink_mixed_traffic, NULL, NULL, NULL, NULL, NULL);
```
