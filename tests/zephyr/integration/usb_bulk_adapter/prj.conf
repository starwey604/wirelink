## CMakeLists.txt
```
# SPDX-License-Identifier: Apache-2.0

cmake_minimum_required(VERSION 3.20.0)

set(WIRELINK_ROOT "${CMAKE_CURRENT_LIST_DIR}/../../../..")
list(APPEND ZEPHYR_EXTRA_MODULES ${WIRELINK_ROOT})

find_package(Zephyr REQUIRED HINTS $ENV{ZEPHYR_BASE})
project(wirelink_usb_bulk_adapter)

if(TEST_USB_NATIVE)
  target_sources(app PRIVATE src/native.c)
  target_compile_definitions(app PRIVATE TEST_USB_NATIVE_ERROR=$<BOOL:${TEST_USB_NATIVE_ERROR}>)
else()
  target_sources(app PRIVATE src/main.c)
endif()
target_sources(app PRIVATE
  ${WIRELINK_ROOT}/adapters/zephyr/usb_bulk/src/usb_bulk.c
)

target_include_directories(app PRIVATE ${WIRELINK_ROOT}/src)

zephyr_ld_options(
  -Wl,--wrap=usbd_ep_enqueue
  -Wl,--wrap=usbd_disable
  -Wl,--wrap=usbd_enable
  -Wl,--wrap=usbd_ep_buf_free
)
```

## prj.conf
```kconfig
CONFIG_ZTEST=y
CONFIG_USB_DEVICE_STACK_NEXT=y
CONFIG_UDC_DRIVER_HIGH_SPEED_SUPPORT_ENABLED=y
CONFIG_MAIN_STACK_SIZE=4096
CONFIG_ZTEST_STACK_SIZE=4096
```

## app.overlay
```dts
/* SPDX-License-Identifier: Apache-2.0 */

/delete-node/ &zephyr_udc0;

/ {
  zephyr_uhc0: uhc_vrt0 {
    compatible = "zephyr,uhc-virtual";

    zephyr_udc0: udc_vrt0 {
      compatible = "zephyr,udc-virtual";
      num-bidir-endpoints = <8>;
      maximum-speed = "high-speed";
    };
  };
};
```

## src/main.c
```c
/* SPDX-License-Identifier: Apache-2.0 */
#include "fixture.h"
NET_BUF_POOL_FIXED_DEFINE(unexpected_request_pool, 1, 0,
                          sizeof(struct udc_buf_info), NULL);
static uint8_t unexpected_data[1];

ZTEST(wirelink_usb_bulk_adapter, test_assigned_endpoints_mps_and_late_cancel) {
  static wl_ctx_t link;
  static wl_zephyr_usb_bulk_t adapter;
  static uint8_t rx_units[3][192];
  static uint8_t tx_payload[128];
  static uint8_t tx_unit[256];
  static uint8_t control_unit[256];
  static uint8_t rx_fallback[256];
  static struct usbd_context context;
  static uint8_t tx_data[16];
  struct usbd_class_data *class_data = bulk_class();
  wl_config_t link_config = {
      .max_payload_len = sizeof(tx_payload),
      .session_id = 1U,
      .max_transmission_unit = sizeof(tx_unit),
  };
  const wl_storage_t storage = {
      .tx_payload = tx_payload,
      .tx_payload_size = sizeof(tx_payload),
      .tx_unit = tx_unit,
      .tx_unit_size = sizeof(tx_unit),
      .control_unit = control_unit,
      .control_unit_size = sizeof(control_unit),
      .rx_fallback = rx_fallback,
      .rx_fallback_size = sizeof(rx_fallback),
  };
  const wl_usb_bulk_config_t usb_config = wl_usb_bulk_native_packet(192U, 3U);
  const wl_zephyr_usb_bulk_config_t adapter_config = {
      .link = &link,
      .transport = usb_config,
  };
  struct net_buf *fs_out_request;
  struct net_buf *fs_in_request;
  struct net_buf *hs_out_request;
  struct net_buf *hs_in_request;
  struct net_buf *reconfigured_out_request;
  struct net_buf *unexpected_request;
  struct udc_buf_info *info;
  wl_zephyr_usb_bulk_stats_t stats;
  uint32_t errors_before_unexpected;

  zassert_not_null(class_data);
  class_data->uds_ctx = &context;
  configure_descriptor(bulk_descriptor(class_data, USBD_SPEED_FS, false),
                       0x02U, 32U);
  configure_descriptor(bulk_descriptor(class_data, USBD_SPEED_FS, true),
                       0x81U, 8U);
  configure_descriptor(bulk_descriptor(class_data, USBD_SPEED_HS, false),
                       0x04U, 64U);
  configure_descriptor(bulk_descriptor(class_data, USBD_SPEED_HS, true),
                       0x83U, 64U);

  zassert_ok(wl_usb_bulk_config_apply(&link_config, usb_config));
  zassert_ok(wl_init(&link, &link_config, &storage));
  zassert_ok(wl_usb_bulk_rx_init(&link, usb_config, &rx_units[0][0], sizeof(rx_units)));
  zassert_ok(wl_zephyr_usb_bulk_init(&adapter, &adapter_config));
  wl_config_t actual;
  zassert_ok(wl_get_config(&link, &actual));
  zassert_equal(actual.integrity, WL_INTEGRITY_NONE);
  zassert_ok(class_data->api->init(class_data));

  context.status.speed = USBD_SPEED_FS;
  complete_out_inline = true;
  class_data->api->enable(class_data);
  zassert_true(wl_zephyr_usb_bulk_readiness(&adapter).runnable,
               "an inline OUT completion must retain its rearm request");
  zassert_ok(wl_zephyr_usb_bulk_service(&adapter));
  wl_zephyr_usb_bulk_get_stats(&adapter, &stats);
  zassert_equal(stats.rx_claims, 2U);
  zassert_equal(stats.rx_completions, 1U);
  fs_out_request = take_queued(0x02U);
  zassert_not_null(fs_out_request);
  zassert_equal(net_buf_tailroom(fs_out_request), 192U,
                "native OUT must preserve the configured unit capacity");
  zassert_equal(adapter.rx_endpoint, 0x02U);

  zassert_ok(wl_send_unreliable(&link, 1U, tx_data, 4U));
  fs_in_request = take_queued(0x81U);
  zassert_not_null(fs_in_request);
  info = udc_get_buf_info(fs_in_request);
  zassert_true(info->zlp, "IN ZLP must use the assigned FS IN MPS");
  zassert_equal(adapter.tx_endpoint, 0x81U);

  class_data->api->disable(class_data);
  context.status.speed = USBD_SPEED_HS;
  class_data->api->enable(class_data);
  zassert_ok(class_data->api->request(class_data, fs_in_request,
                                     -ECONNABORTED));
  zassert_ok(wl_zephyr_usb_bulk_service(&adapter));
  zassert_ok(class_data->api->request(class_data, fs_out_request,
                                     -ECONNABORTED));
  zassert_ok(wl_zephyr_usb_bulk_service(&adapter));

  hs_out_request = take_queued(0x04U);
  zassert_not_null(hs_out_request);
  zassert_equal(net_buf_tailroom(hs_out_request), 192U,
                "native OUT capacity must survive speed reconfiguration");
  zassert_equal(adapter.rx_endpoint, 0x04U);

  zassert_ok(wl_send_unreliable(&link, 2U, tx_data, 1U));
  hs_in_request = take_queued(0x83U);
  zassert_not_null(hs_in_request);
  info = udc_get_buf_info(hs_in_request);
  zassert_false(info->zlp, "IN ZLP must use the assigned HS IN MPS");

  class_data->api->disable(class_data);
  context.status.speed = USBD_SPEED_FS;
  zassert_ok(class_data->api->request(class_data, hs_in_request,
                                     -ECONNABORTED));
  zassert_ok(wl_zephyr_usb_bulk_service(&adapter));
  wl_zephyr_usb_bulk_get_stats(&adapter, &stats);
  zassert_false(stats.tx_active);
  zassert_ok(class_data->api->request(class_data, hs_out_request,
                                     -ECONNABORTED));
  zassert_ok(wl_zephyr_usb_bulk_service(&adapter));

  wl_zephyr_usb_bulk_get_stats(&adapter, &stats);
  zassert_false(stats.enabled);
  zassert_false(stats.rx_active);
  zassert_false(stats.tx_active);
  zassert_equal(adapter.rx_endpoint, 0U);
  zassert_equal(adapter.tx_endpoint, 0U);

  class_data->api->enable(class_data);
  reconfigured_out_request = take_queued(0x02U);
  zassert_not_null(reconfigured_out_request,
                   "reconfiguration must use the assigned FS OUT endpoint");
  class_data->api->disable(class_data);
  zassert_ok(class_data->api->request(class_data, reconfigured_out_request,
                                     -ECONNABORTED));
  zassert_ok(wl_zephyr_usb_bulk_service(&adapter));

  wl_zephyr_usb_bulk_get_stats(&adapter, &stats);
  errors_before_unexpected = stats.errors;
  unexpected_request =
      net_buf_alloc_with_data(&unexpected_request_pool, unexpected_data,
                              sizeof(unexpected_data), K_NO_WAIT);
  zassert_not_null(unexpected_request);
  udc_get_buf_info(unexpected_request)->ep = 0x07U;
  zassert_equal(class_data->api->request(class_data, unexpected_request, 0),
                -EINVAL);

  wl_zephyr_usb_bulk_get_stats(&adapter, &stats);
  zassert_false(stats.enabled);
  zassert_false(stats.rx_active);
  zassert_false(stats.tx_active);
  zassert_equal(adapter.rx_endpoint, 0U);
  zassert_equal(adapter.tx_endpoint, 0U);
  zassert_equal(stats.errors, errors_before_unexpected + 1U);
}

ZTEST_SUITE(wirelink_usb_bulk_adapter, NULL, NULL, NULL, NULL, NULL);
```

## src/fixture.h
```c
/* SPDX-License-Identifier: Apache-2.0 */

#include <errno.h>
#include <string.h>

#include <zephyr/drivers/usb/udc.h>
#include <zephyr/net_buf.h>
#include <zephyr/sys/byteorder.h>
#include <zephyr/sys/iterable_sections.h>
#include <zephyr/usb/usbd.h>
#include <zephyr/ztest.h>

#include "wirelink/zephyr/usb_bulk.h"

#define QUEUED_REQUESTS 5U


struct queued_request {
  const struct usbd_class_data *class_data;
  struct net_buf *buffer;
};

static struct queued_request queued[QUEUED_REQUESTS];
static size_t queued_count;
static bool complete_out_inline;

int __wrap_usbd_ep_enqueue(const struct usbd_class_data *class_data,
                           struct net_buf *buffer) {
  struct udc_buf_info *info = udc_get_buf_info(buffer);

  if (complete_out_inline && !USB_EP_DIR_IS_IN(info->ep)) {
    complete_out_inline = false;
    zassert_ok(class_data->api->request((struct usbd_class_data *)class_data,
                                       buffer, 0));
    return 0;
  }
  info->owner = (void *)class_data;
  for (size_t index = 0U; index < queued_count; ++index) {
    if (queued[index].buffer == NULL) {
      queued[index] =
          (struct queued_request){.class_data = class_data, .buffer = buffer};
      return 0;
    }
  }
  zassert_true(queued_count < ARRAY_SIZE(queued));
  queued[queued_count++] =
      (struct queued_request){.class_data = class_data, .buffer = buffer};
  return 0;
}

int __wrap_usbd_ep_buf_free(struct usbd_context *context,
                            struct net_buf *buffer) {
  ARG_UNUSED(context);
  net_buf_unref(buffer);
  return 0;
}

static struct usbd_class_data *bulk_class(void) {
  STRUCT_SECTION_FOREACH_ALTERNATE(usbd_class_fs, usbd_class_node, node) {
    if (strcmp(node->c_data->name, "wirelink_bulk_0") == 0) {
      return node->c_data;
    }
  }
  return NULL;
}

static struct usb_ep_descriptor *bulk_descriptor(
    struct usbd_class_data *class_data, enum usbd_speed speed, bool in) {
  struct usb_desc_header *const *headers =
      class_data->api->get_desc(class_data, speed);

  for (; *headers != NULL && (*headers)->bLength != 0U; ++headers) {
    if ((*headers)->bDescriptorType == USB_DESC_ENDPOINT) {
      struct usb_ep_descriptor *endpoint =
          (struct usb_ep_descriptor *)(*headers);

      if (USB_EP_DIR_IS_IN(endpoint->bEndpointAddress) == in) {
        return endpoint;
      }
    }
  }
  return NULL;
}

static struct net_buf *take_queued(uint8_t endpoint) {
  for (size_t index = 0U; index < queued_count; ++index) {
    struct net_buf *buffer = queued[index].buffer;

    if (buffer != NULL && udc_get_buf_info(buffer)->ep == endpoint) {
      queued[index].buffer = NULL;
      return buffer;
    }
  }
  return NULL;
}

static void configure_descriptor(struct usb_ep_descriptor *descriptor,
                                 uint8_t endpoint, uint16_t packet_size) {
  zassert_not_null(descriptor);
  descriptor->bEndpointAddress = endpoint;
  descriptor->wMaxPacketSize = sys_cpu_to_le16(packet_size);
}


static int disable_result, enable_result;
static unsigned disable_calls, enable_calls;
int __wrap_usbd_disable(struct usbd_context *context) {
  ARG_UNUSED(context);
  ++disable_calls;
  if (disable_result == 0) bulk_class()->api->disable(bulk_class());
  return disable_result;
}
int __wrap_usbd_enable(struct usbd_context *context) {
  ARG_UNUSED(context);
  ++enable_calls;
  /* A successful controller enable is not SET_CONFIGURATION yet. */
  return enable_result;
}
```

## src/native.c
```c
/* SPDX-License-Identifier: Apache-2.0 */
/* Exercise the real class callbacks and queue with a controlled UDC boundary. */
#include "fixture.h"
#include "wirelink/frame.h"

static struct net_buf *native_complete(struct usbd_class_data *class_data,
                                       wl_zephyr_usb_bulk_t *adapter,
                                       struct net_buf *buffer, size_t length,
                                       int error) {
  net_buf_add(buffer, length);
  zassert_ok(class_data->api->request(class_data, buffer, error));
  int result = wl_zephyr_usb_bulk_service(adapter);
  zassert_true(result == WL_OK || result == WL_ERR_WOULD_BLOCK || result == WL_ERR_IO);
  return take_queued(0x01U);
}

ZTEST(wirelink_usb_native, test_native_completion_contract) {
  static wl_ctx_t link;
  static wl_zephyr_usb_bulk_t adapter;
  static uint8_t tx_payload[1032], tx_unit[1052], control_unit[20];
  static uint8_t fallback[1052], units[2][2048];
  static struct usbd_context context;
  wl_config_t config = {.max_payload_len = sizeof(tx_payload),
      .envelope = WL_ENVELOPE_NATIVE_PACKET, .integrity = WL_INTEGRITY_NONE,
      .session_id = 1U, .max_transmission_unit = sizeof(tx_unit)};
  wl_storage_t storage = {.tx_payload = tx_payload, .tx_payload_size = sizeof(tx_payload),
      .tx_unit = tx_unit, .tx_unit_size = sizeof(tx_unit),
      .control_unit = control_unit, .control_unit_size = sizeof(control_unit),
      .rx_fallback = fallback, .rx_fallback_size = sizeof(fallback)};
  const wl_usb_bulk_config_t usb_config = wl_usb_bulk_native_packet(2048, 2);
  wl_zephyr_usb_bulk_config_t adapter_config = {.link = &link, .transport = usb_config};
  struct usbd_class_data *class_data = bulk_class();
  wl_zephyr_usb_bulk_stats_t before, after;
  wl_event_t event;
  uint8_t payload[60];
  size_t length;
  memset(payload, 0x5a, sizeof(payload));
  wl_wire_packet_t packet = {.type = WL_PACKET_DATA, .integrity = WL_INTEGRITY_NONE,
      .message_id = 103U, .payload = payload, .payload_len = sizeof(payload)};

  class_data->uds_ctx = &context;
  context.status.speed = USBD_SPEED_FS;
  configure_descriptor(bulk_descriptor(class_data, USBD_SPEED_FS, false), 0x01, 64);
  configure_descriptor(bulk_descriptor(class_data, USBD_SPEED_FS, true), 0x81, 64);
  zassert_ok(wl_usb_bulk_config_apply(&config, usb_config));
  zassert_ok(wl_init(&link, &config, &storage));
  zassert_equal(wl_zephyr_usb_bulk_init(&adapter, &adapter_config), WL_ERR_NOT_INITIALIZED);
  zassert_ok(wl_usb_bulk_rx_init(&link, usb_config, &units[0][0], sizeof(units)));
  adapter_config.transport.rx_capacity = 1048U;
  zassert_equal(wl_zephyr_usb_bulk_init(&adapter, &adapter_config), WL_ERR_BUF_TOO_SMALL);
  adapter_config.transport = usb_config;
  zassert_ok(wl_zephyr_usb_bulk_init(&adapter, &adapter_config));
  complete_out_inline = true;
  class_data->api->enable(class_data);
  zassert_true(wl_zephyr_usb_bulk_readiness(&adapter).runnable);
  zassert_ok(wl_zephyr_usb_bulk_service(&adapter));
  struct net_buf *buffer = take_queued(0x01);
  zassert_not_null(buffer);
  zassert_equal(net_buf_tailroom(buffer), 2048U);

  /* Two committed slots stay borrowed through the event lease. */
  zassert_ok(wl_frame_encode(&packet, WL_ENVELOPE_NATIVE_PACKET,
      buffer->data, net_buf_tailroom(buffer), &length));
  zassert_equal(length, 64U);
  buffer = native_complete(class_data, &adapter, buffer, length, 0);
  zassert_not_null(buffer);
  zassert_ok(wl_frame_encode(&packet, WL_ENVELOPE_NATIVE_PACKET,
      buffer->data, net_buf_tailroom(buffer), &length));
  buffer = native_complete(class_data, &adapter, buffer, length, 0);
  zassert_is_null(buffer, "queue full must pause the producer");
  zassert_ok(wl_poll(&link, 0, &event));
  zassert_equal(event.type, WL_EVT_UNRELIABLE_RX);
  zassert_mem_equal(event.payload, payload, sizeof(payload));
  zassert_equal(wl_zephyr_usb_bulk_service(&adapter), WL_ERR_WOULD_BLOCK);
  zassert_is_null(take_queued(0x01), "leased slot must not rearm");
  wl_event_release(&link, &event);
  zassert_ok(wl_zephyr_usb_bulk_service(&adapter));
  buffer = take_queued(0x01);
  zassert_not_null(buffer);
  zassert_ok(wl_poll(&link, 0, &event));
  zassert_equal(event.type, WL_EVT_UNRELIABLE_RX);
  wl_event_release(&link, &event);

  /* A successful empty transfer returns the claim without a frame or error. */
  wl_rx_unit_claim_t old_claim = adapter.rx_unit_claim;
  wl_zephyr_usb_bulk_get_stats(&adapter, &before);
  buffer = native_complete(class_data, &adapter, buffer, 0, 0);
  wl_zephyr_usb_bulk_get_stats(&adapter, &after);
  zexpect_equal(after.errors, before.errors, "empty success is not an IO error");
  zassert_not_null(buffer, "empty success must rearm");
  zexpect_equal(wl_rx_unit_abort(&link, &old_claim), WL_ERR_NOT_FOUND);
  zexpect_equal(wl_rx_unit_commit(&link, &old_claim, 64), WL_ERR_NOT_FOUND);
  zexpect_equal(wl_poll(&link, 0, &event), WL_ERR_NO_DATA);

  /* Re-enable may precede the old request's cancellation callback. */
  wl_zephyr_usb_bulk_get_stats(&adapter, &before);
  class_data->api->disable(class_data);
  class_data->api->enable(class_data);
  buffer = native_complete(class_data, &adapter, buffer, 0, -ECONNABORTED);
  wl_zephyr_usb_bulk_get_stats(&adapter, &after);
  zexpect_equal(after.errors, before.errors, "old cancellation is not a new boundary fault");
  zassert_not_null(buffer, "late cancellation must rearm the new configuration");

  /* A full request cannot establish that the terminating short packet/ZLP
   * has been consumed. It must never be committed as a complete unit. */
  memset(buffer->data, 0, net_buf_tailroom(buffer));
  wl_zephyr_usb_bulk_get_stats(&adapter, &before);
  buffer = native_complete(class_data, &adapter, buffer,
      TEST_USB_NATIVE_ERROR ? 12 : 2048, TEST_USB_NATIVE_ERROR ? -ETIMEDOUT : 0);
  wl_zephyr_usb_bulk_get_stats(&adapter, &after);
  zexpect_equal(after.rx_bytes, before.rx_bytes, "unterminated unit was committed");
  zexpect_is_null(buffer, "lost boundary must stay stopped until transport reset");
  zexpect_true(after.errors > before.errors);
  const wl_usb_bulk_rx_fault_t fault = TEST_USB_NATIVE_ERROR
      ? WL_USB_BULK_RX_FAULT_TRANSFER : WL_USB_BULK_RX_FAULT_BOUNDARY_LOST;
  zassert_equal(wl_zephyr_usb_bulk_rx_fault(&adapter), fault);
  zassert_equal(wl_zephyr_usb_bulk_service(&adapter), WL_ERR_IO);
  zassert_false(wl_zephyr_usb_bulk_readiness(&adapter).runnable);
  wl_zephyr_usb_bulk_reset_stats(&adapter);
  wl_zephyr_usb_bulk_get_stats(&adapter, &after);
  zassert_equal(after.errors, 0U);
  zassert_equal(after.rx_fault, fault, "telemetry reset cannot erase recovery state");
  class_data->api->enable(class_data);
  zassert_equal(wl_zephyr_usb_bulk_rx_fault(&adapter), fault);
  zassert_is_null(take_queued(0x01), "enable without disable is not recovery");
  if (buffer != NULL) {
    /* Keep the independent timeout failure even if the full-size check failed. */
    wl_zephyr_usb_bulk_get_stats(&adapter, &before);
    buffer = native_complete(class_data, &adapter, buffer, 12, -ETIMEDOUT);
    wl_zephyr_usb_bulk_get_stats(&adapter, &after);
    zexpect_equal(after.rx_bytes, before.rx_bytes);
    zexpect_is_null(buffer, "timeout suffix must not be accepted as a new frame");
    zexpect_true(after.errors > before.errors);
  }
  /* Public recovery requests a real context disable/enable. Wrappers model
   * only lifecycle calls; this is not a physical disconnect/controller test. */
  disable_result = -EIO;
  zassert_equal(wl_zephyr_usb_bulk_recover(&adapter), WL_ERR_IO);
  zassert_equal(wl_zephyr_usb_bulk_rx_fault(&adapter), fault);
  disable_result = 0; enable_result = -EIO;
  zassert_equal(wl_zephyr_usb_bulk_recover(&adapter), WL_ERR_IO);
  unsigned disabled = disable_calls;
  enable_result = 0;
  zassert_ok(wl_zephyr_usb_bulk_recover(&adapter));
  zassert_equal(disable_calls, disabled, "retry enable after disable succeeded");
  zassert_equal(wl_zephyr_usb_bulk_recover(&adapter), WL_ERR_WOULD_BLOCK);
  zassert_equal(wl_zephyr_usb_bulk_rx_fault(&adapter), fault,
                "wait for actual host configuration");
  class_data->api->enable(class_data);
  zassert_equal(wl_zephyr_usb_bulk_rx_fault(&adapter), WL_USB_BULK_RX_FAULT_NONE);
  buffer = take_queued(0x01);
  zassert_not_null(buffer);
  zassert_ok(wl_frame_encode(&packet, WL_ENVELOPE_NATIVE_PACKET,
      buffer->data, net_buf_tailroom(buffer), &length));
  buffer = native_complete(class_data, &adapter, buffer, length, 0);
  zassert_not_null(buffer);
  zassert_ok(wl_poll(&link, 0, &event));
  zassert_mem_equal(event.payload, payload, sizeof(payload));
  wl_event_release(&link, &event);
  /* A fast bus reconfiguration must not erase an unobserved fault report. */
  net_buf_add(buffer, net_buf_tailroom(buffer));
  zassert_ok(class_data->api->request(class_data, buffer, 0));
  zassert_true(wl_zephyr_usb_bulk_readiness(&adapter).runnable);
  class_data->api->disable(class_data);
  class_data->api->enable(class_data);
  zassert_equal(wl_zephyr_usb_bulk_rx_fault(&adapter), WL_USB_BULK_RX_FAULT_NONE);
  zassert_true(wl_zephyr_usb_bulk_readiness(&adapter).runnable);
  zassert_equal(wl_zephyr_usb_bulk_service(&adapter), WL_ERR_IO);
  wl_zephyr_usb_bulk_get_stats(&adapter, &after);
  zassert_equal(after.last_rx_fault, WL_USB_BULK_RX_FAULT_BOUNDARY_LOST);
  zassert_false(wl_zephyr_usb_bulk_readiness(&adapter).runnable);
  buffer = take_queued(0x01);
  zassert_not_null(buffer);
  class_data->api->disable(class_data);
  (void)native_complete(class_data, &adapter, buffer, 0, -ECONNABORTED);
}

ZTEST_SUITE(wirelink_usb_native, NULL, NULL, NULL, NULL, NULL);
```
