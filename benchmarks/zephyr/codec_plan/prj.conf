## CMakeLists.txt
```
# SPDX-License-Identifier: Apache-2.0
cmake_minimum_required(VERSION 3.20)
find_package(Zephyr REQUIRED HINTS $ENV{ZEPHYR_BASE})
project(wirelink_codec_plan_cpu LANGUAGES C)
if(NOT DEFINED CODEC_PLAN_EXPECT_LTO)
  if(CONFIG_LTO)
    set(CODEC_PLAN_EXPECT_LTO ON)
  else()
    set(CODEC_PLAN_EXPECT_LTO OFF)
  endif()
endif()
if(CODEC_PLAN_EXPECT_LTO AND NOT CONFIG_LTO)
  message(FATAL_ERROR "LTO requested but not enabled by Kconfig; do not label this an LTO measurement")
elseif(NOT CODEC_PLAN_EXPECT_LTO AND CONFIG_LTO)
  message(FATAL_ERROR "No-LTO comparison unexpectedly enabled LTO")
endif()
if(NOT EXISTS "${CODEC_PLAN_CODEC_DIR}/plan.c")
  message(FATAL_ERROR "Provide frozen generated CODEC_PLAN_CODEC_DIR")
endif()
target_sources(app PRIVATE src/main.c ../../codec_plan/workload.c "${CODEC_PLAN_CODEC_DIR}/plan.c")
target_include_directories(app PRIVATE ../../codec_plan "${CODEC_PLAN_CODEC_DIR}")
```

## prj.conf
```kconfig
CONFIG_WIRELINK=y
CONFIG_TIMING_FUNCTIONS=y
CONFIG_CAN=n
CONFIG_PWM=n
CONFIG_LED=n
CONFIG_SERIAL=y
CONFIG_CONSOLE=y
CONFIG_UART_CONSOLE=y
CONFIG_MAIN_STACK_SIZE=4096
CONFIG_PRINTK=y
CONFIG_LOG=n
CONFIG_ASSERT=y
CONFIG_SPEED_OPTIMIZATIONS=y
# The ESP32-S3 Xtensa toolchain does not support LTO. See lto.conf for hosts
# that do.
```

## lto.conf
```kconfig
# Enable link-time optimization on hosts whose toolchain supports it.
# Pair with -DEXTRA_CONF_FILE=.../lto.conf -DCODEC_PLAN_EXPECT_LTO=ON.
CONFIG_LTO=y
CONFIG_ISR_TABLES_LOCAL_DECLARATION=y
```

## no_lto.conf
```kconfig
# Diagnostic comparison only; the primary product-like configuration enables LTO.
CONFIG_LTO=n
```

## src/main.c
```c
/* SPDX-License-Identifier: Apache-2.0 */
#include "workload.h"
#include <zephyr/kernel.h>
#include <zephyr/timing/timing.h>

#if defined(CONFIG_CPU_CORTEX_M)
#include <cmsis_core.h>
#define CODEC_PLAN_INVALIDATE_ICACHE() SCB_InvalidateICache()
#else
/* No portable instruction-cache flush exists for this architecture, so the
 * mode-1 cold-entry step is a no-op. */
#define CODEC_PLAN_INVALIDATE_ICACHE() ((void)0)
#endif
static codec_plan_fixture_t fixtures[CODEC_PLAN_KINDS];
int main(void) {
  /* Let the USB Serial/JTAG console attach after reset before printing. */
  k_sleep(K_MSEC(2000));
  timing_init(); timing_start();
  printk("codec_plan_begin_v1,hz=%llu,lto=%u,barriers=1\n", (unsigned long long)timing_freq_get(), IS_ENABLED(CONFIG_LTO));
  /* mode 0: warm homogeneous; mode 1: I-cache invalidated before each sample;
   * mode 2: round-robin messages. No invalidation is inside measured cycles. */
  for (unsigned mode = 0; mode < 3; ++mode)
    for (unsigned kind = 0; kind < (mode == 2 ? 1U : CODEC_PLAN_KINDS); ++kind)
      for (unsigned pattern = 0; pattern < CODEC_PLAN_PATTERNS; ++pattern)
        for (unsigned stage = 0; stage < CODEC_PLAN_STAGES; ++stage) {
          for (unsigned k = 0; k < CODEC_PLAN_KINDS; ++k)
            __ASSERT_NO_MSG(codec_plan_init(&fixtures[k], k, pattern, stage) == WL_CODEC_OK);
          for (unsigned i = 0; i < 32; ++i)
            __ASSERT_NO_MSG(codec_plan_step(&fixtures[mode == 2 ? i % CODEC_PLAN_KINDS : kind]) == WL_CODEC_OK);
          for (unsigned r = 0; r < 5; ++r) {
            uint64_t total = 0;
            const unsigned batch = mode == 2 ? 36U : 32U;
            for (unsigned i = 0; i < batch; ++i) {
              codec_plan_fixture_t *f = &fixtures[mode == 2 ? i % CODEC_PLAN_KINDS : kind];
              unsigned lock = irq_lock();
              if (mode == 1) CODEC_PLAN_INVALIDATE_ICACHE();
              timing_t start = timing_counter_get();
              compiler_barrier();
              int result = codec_plan_step(f);
              compiler_barrier();
              timing_t end = timing_counter_get();
              irq_unlock(lock);
              __ASSERT_NO_MSG(result == WL_CODEC_OK);
              __ASSERT_NO_MSG(stage != 2 || f->output_length == f->expected_length);
              total += timing_cycles_get(&start, &end);
            }
            for (unsigned k = 0; k < CODEC_PLAN_KINDS; ++k)
              __ASSERT_NO_MSG(codec_plan_check(&fixtures[k]) == WL_CODEC_OK);
            printk("codec_plan_v1,m=%u,k=%u,p=%u,s=%u,r=%u,n=%u,cycles=%llu\n",
                mode, kind, pattern, stage, r, batch, (unsigned long long)total);
          }
          k_sleep(K_MSEC(10));
        }
  printk("codec_plan_end_v1,groups=225,samples=1125,result=pass\n");
  return 0;
}
```
