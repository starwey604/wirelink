## CMakeLists.txt
```
# SPDX-License-Identifier: Apache-2.0
cmake_minimum_required(VERSION 3.28.0)
set(RAGTIME_FIRMWARES_ROOT "" CACHE PATH "Existing Ragtime Zephyr workspace (read-only source)")
if(NOT EXISTS "${RAGTIME_FIRMWARES_ROOT}/firmware/tests/apps/willow_wirelink_hil/src/main.cpp")
  message(FATAL_ERROR "Set RAGTIME_FIRMWARES_ROOT to the existing product workspace")
endif()
set(ENV{RAGTIME_FIRMWARES_ROOT} "${RAGTIME_FIRMWARES_ROOT}")
set(HIL_ROOT "${RAGTIME_FIRMWARES_ROOT}/firmware/tests/apps/willow_wirelink_hil")
set(CONF_FILE "${HIL_ROOT}/prj.conf;${HIL_ROOT}/boards/dm_mc02_stm32h723xx.conf;${CMAKE_CURRENT_SOURCE_DIR}/prj.conf")
set(DTC_OVERLAY_FILE "${HIL_ROOT}/boards/dm_mc02_stm32h723xx.overlay")
find_package(Zephyr REQUIRED HINTS $ENV{ZEPHYR_BASE})
project(wirelink_willow_cpu LANGUAGES C CXX)
option(WIRELINK_H7_LOCK_PROFILING "Measure ArmProtocol state spinlocks (test-only)" ON)
target_sources(app PRIVATE "${HIL_ROOT}/src/main.cpp" src/main.cpp src/spin_profile.cpp)
set_source_files_properties("${HIL_ROOT}/src/main.cpp" PROPERTIES COMPILE_DEFINITIONS "main=willow_hil_main")
target_link_libraries(app PRIVATE fci_protocol::arm)
if(WIRELINK_H7_LOCK_PROFILING)
  get_property(libraries GLOBAL PROPERTY ZEPHYR_LIBS)
  set(found FALSE)
  foreach(library IN LISTS libraries)
    if(library MATCHES "arm_protocol$")
      # Force include ONLY in this test's ArmProtocol library, not kernel/USB.
      target_compile_options(${library} PRIVATE -include "${CMAKE_CURRENT_SOURCE_DIR}/src/spin_profile.hpp")
      set(found TRUE)
    endif()
  endforeach()
  if(NOT found)
    message(FATAL_ERROR "ArmProtocol target was not found; refusing an uninstrumented result")
  endif()
  target_compile_definitions(app PRIVATE WL_H7_LOCK_PROFILING=1)
endif()
```

## Kconfig
```
# SPDX-License-Identifier: Apache-2.0
source "$(RAGTIME_FIRMWARES_ROOT)/firmware/tests/apps/willow_wirelink_hil/Kconfig"
```

## prj.conf
```kconfig
# SPDX-License-Identifier: Apache-2.0
CONFIG_THREAD_RUNTIME_STATS=y
CONFIG_THREAD_RUNTIME_STATS_USE_TIMING_FUNCTIONS=y
CONFIG_THREAD_NAME=y
CONFIG_THREAD_MONITOR=y
CONFIG_PRINTK=y
CONFIG_ASSERT=y
CONFIG_LOG_BUFFER_SIZE=8192
CONFIG_SEGGER_RTT_BUFFER_SIZE_UP=16384
```

## src/main.cpp
```c
/* SPDX-License-Identifier: Apache-2.0 */
#define WL_SPIN_PROFILE_IMPLEMENTATION
#include "spin_profile.hpp"
#include <zephyr/logging/log.h>
LOG_MODULE_REGISTER(wirelink_cpu, LOG_LEVEL_INF);
int willow_hil_main();
static k_tid_t owner;
K_SEM_DEFINE(ready, 0, 1);

static void report(void *, void *, void *) {
  k_sem_take(&ready, K_FOREVER);
  k_thread_runtime_stats_t previous_owner{}, previous_cpu{};
  (void)k_thread_runtime_stats_get(owner, &previous_owner);
  (void)k_thread_runtime_stats_all_get(&previous_cpu);
  auto previous_lock = spin_snapshot();
  auto previous_ms = k_uptime_get();
  unsigned window = 0;
  for (;;) {
    k_sleep(K_SECONDS(2));
    const auto now_ms = k_uptime_get();
    k_thread_runtime_stats_t current_owner{}, current_cpu{};
    const int a = k_thread_runtime_stats_get(owner, &current_owner);
    const int b = k_thread_runtime_stats_all_get(&current_cpu);
    __ASSERT(a == 0 && b == 0, "CPU statistics unavailable");
    const auto locks = spin_snapshot();
    // Scheduler accounting, not wall time of owner passes. IRQ attribution
    // follows Zephyr's architecture; this is not an IRQ-exclusive instruction count.
    LOG_INF("wl_h7_cpu_v1,w=%u,ms=%lld,hz=%llu,owner=%llu,busy=%llu,total=%llu",
      window, (long long)(now_ms - previous_ms), (unsigned long long)timing_freq_get(),
      (unsigned long long)(current_owner.execution_cycles - previous_owner.execution_cycles),
      (unsigned long long)(current_cpu.total_cycles - previous_cpu.total_cycles),
      (unsigned long long)(current_cpu.execution_cycles - previous_cpu.execution_cycles));
    LOG_INF("wl_h7_lock_v1,w=%u,n=%llu,wait=%llu,hold=%llu,waitmax=%u,holdmax=%u,on=%u",
      window++, (unsigned long long)(locks.calls - previous_lock.calls),
      (unsigned long long)(locks.wait_cycles - previous_lock.wait_cycles),
      (unsigned long long)(locks.hold_cycles - previous_lock.hold_cycles),
      locks.wait_max, locks.hold_max, IS_ENABLED(WL_H7_LOCK_PROFILING));
    previous_owner = current_owner; previous_cpu = current_cpu;
    previous_lock = locks; previous_ms = now_ms;
  }
}
K_THREAD_DEFINE(cpu_report, 4096, report, nullptr, nullptr, nullptr, 12, 0, 0);

int main() {
  owner = k_current_get();
  k_thread_name_set(owner, "wl_owner");
  LOG_INF("wl_h7_cpu_ready_v1,lock_profile=%u,no_motor_can=1", IS_ENABLED(WL_H7_LOCK_PROFILING));
  k_sem_give(&ready);
  return willow_hil_main();
}
```

## src/spin_profile.cpp
```c
/* SPDX-License-Identifier: Apache-2.0 */
#define WL_SPIN_PROFILE_IMPLEMENTATION
#include "spin_profile.hpp"
#include <algorithm>

BUILD_ASSERT(!IS_ENABLED(CONFIG_SMP), "This H7 diagnostic relies on single-core IRQ exclusion");
static SpinSnapshot totals;
static k_spinlock *held;
static uint32_t acquired;

k_spinlock_key_t measured_spin_lock(k_spinlock *lock) {
  const uint32_t begin = timing_counter_get();
  const auto key = k_spin_lock(lock);
  const uint32_t end = timing_counter_get();
  __ASSERT(held == nullptr, "nested profiled locks are not supported");
  held = lock;
  acquired = end;
  const uint32_t wait = end - begin;
  ++totals.calls;
  totals.wait_cycles += wait;
  totals.wait_max = std::max(totals.wait_max, wait);
  return key;
}
void measured_spin_unlock(k_spinlock *lock, k_spinlock_key_t key) {
  const uint32_t end = timing_counter_get();
  __ASSERT(held == lock, "unpaired profiled unlock");
  const uint32_t hold = end - acquired;
  totals.hold_cycles += hold;
  totals.hold_max = std::max(totals.hold_max, hold);
  held = nullptr;
  k_spin_unlock(lock, key);
}
SpinSnapshot spin_snapshot() {
  // Do not use a profiled spinlock to copy the profiling counters.
  const auto key = irq_lock();
  const auto copy = totals;
  irq_unlock(key);
  return copy;
}
```

## src/spin_profile.hpp
```c
/* SPDX-License-Identifier: Apache-2.0 */
#pragma once
#include <zephyr/kernel.h>
#include <zephyr/spinlock.h>
#include <zephyr/timing/timing.h>
#include <cstdint>

struct SpinSnapshot {
  uint64_t calls{}, wait_cycles{}, hold_cycles{};
  uint32_t wait_max{}, hold_max{};
};
SpinSnapshot spin_snapshot();
k_spinlock_key_t measured_spin_lock(k_spinlock *lock);
void measured_spin_unlock(k_spinlock *lock, k_spinlock_key_t key);
#ifndef WL_SPIN_PROFILE_IMPLEMENTATION
#define k_spin_lock(lock) measured_spin_lock(lock)
#define k_spin_unlock(lock, key) measured_spin_unlock(lock, key)
#endif
```
