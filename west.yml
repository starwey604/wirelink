## west.yml
```yaml
# West manifest for a standalone Wirelink development workspace.
#
# Usage:
#   west init -m https://github.com/starwey604/wirelink <workspace>
#   cd <workspace>
#   west update
manifest:
  version: "1.2"

  remotes:
    - name: zephyrproject-rtos
      url-base: https://github.com/zephyrproject-rtos

  projects:
    - name: zephyr
      remote: zephyrproject-rtos
      revision: main
      import: true

  self:
    path: wirelink
```

## zephyr/Kconfig
```kconfig
# SPDX-License-Identifier: Apache-2.0
menu "Wirelink"
config WIRELINK
	bool "Enable the static Wirelink endpoint kernel"
	default y
	help
	  Portable C11 packet ownership and bounded four-call/four-reply execution.
	  Best-effort ordinary DATA only: no ARQ, ACK state, replay or deferred reply.
	  Select one wire connector in each version2 binding profile.
if WIRELINK
config WIRELINK_PLATFORM
	bool "Native clock and fresh-instance environment"
	default y if CSPRNG_ENABLED
	help
	  Initialization-only platform clock/session providers; no core clock reads.
	  Set CSPRNG_NEEDED to request hardware entropy if it is not enabled.
config WIRELINK_PACKET_LOOPBACK
	bool "Single-owner in-process packet loopback"
config WIRELINK_PACKET_STREAM
	bool
config WIRELINK_FRAMING_PRIMITIVES
	bool "Independent COBS and CRC primitives"
config WIRELINK_STREAM_COBS_CRC16
	bool "COBS/CRC16 packet connector"
	select WIRELINK_PACKET_STREAM
	select WIRELINK_FRAMING_PRIMITIVES
config WIRELINK_STREAM_LENGTH16_NONE
	bool "Length16/NONE packet connector"
	select WIRELINK_PACKET_STREAM
config WIRELINK_BYTE_FIFO
	bool "Independent SPSC byte staging"
config WIRELINK_BYTE_FIFO_COBS
	bool
	select WIRELINK_BYTE_FIFO
	select WIRELINK_STREAM_COBS_CRC16
config WIRELINK_ZEPHYR_WAIT
	bool "Latched owner wait and stop notification"
	depends on MULTITHREADING
	help
	  Static semaphore, no internal thread, RPC table or protocol callback.
config WIRELINK_ZEPHYR_UART_DMA
	bool "Asynchronous UART packet adapter"
	depends on SERIAL && UART_ASYNC_API
	select CACHE_MANAGEMENT if DCACHE
	select WIRELINK_BYTE_FIFO_COBS
	help
	  Callbacks stage bytes only. Owner decodes COBS and drives the endpoint.
	  Stop waits for actual DMA buffer returns and callback quiescence.
config WIRELINK_ZEPHYR_USB_BULK
	bool "Native/NONE USB vendor bulk packet adapter"
	depends on USB_DEVICE_STACK_NEXT
	help
	  Two caller-owned RX units, one physical read/write, explicit boundary
	  faults and real cancellation acknowledgement; no protocol work in I/O.
config WIRELINK_ZEPHYR_USB_BULK_DEVICE
	bool "Standalone Wirelink USB bulk device"
	default n
	depends on WIRELINK_ZEPHYR_USB_BULK
if WIRELINK_ZEPHYR_USB_BULK_DEVICE
config WIRELINK_ZEPHYR_USB_BULK_VID
	hex "Vendor ID"
	default 0x2fe3
config WIRELINK_ZEPHYR_USB_BULK_PID
	hex "Product ID"
	default 0x574c
config WIRELINK_ZEPHYR_USB_BULK_MANUFACTURER
	string "Manufacturer"
	default "Wirelink"
config WIRELINK_ZEPHYR_USB_BULK_PRODUCT
	string "Product"
	default "Wirelink USB Bulk"
config WIRELINK_ZEPHYR_USB_BULK_MAX_POWER
	int "Maximum bus power (2 mA units)"
	range 0 250
	default 100
endif
config WIRELINK_ZEPHYR_UART_POLL_EXPERIMENTAL
	bool "Experimental physical UART polling packet adapter"
	depends on SERIAL && MULTITHREADING
	select WIRELINK_BYTE_FIFO_COBS
	help
	  Static RX worker stages bytes. Polling TX reports consumed, and a required
	  platform tx_idle callback confirms actual physical drain before reuse.
config WIRELINK_ZEPHYR_UART_IRQ
	bool "Interrupt-driven UART packet adapter"
	depends on SERIAL && UART_INTERRUPT_DRIVEN
	select WIRELINK_BYTE_FIFO_COBS
	help
	  ISR stages bytes; owner parses. By default TX completes at FIFO acceptance.
	  Select wait_for_tx_idle in the adapter config for physical line idle.
config WIRELINK_ZEPHYR_UART_IRQ_TIMING
	bool "UART callback timing diagnostics"
	depends on WIRELINK_ZEPHYR_UART_IRQ
config WIRELINK_ZEPHYR_UART_IRQ_NOTIFICATION_DIAGNOSTICS
	bool "UART notification diagnostics"
	depends on WIRELINK_ZEPHYR_UART_IRQ
config WIRELINK_ZEPHYR_UDP
	bool "Native IPv4 UDP packet adapter"
	depends on MULTITHREADING && NET_SOCKETS && NET_NATIVE_IPV4 && NET_NATIVE_UDP
	depends on !NET_SOCKETS_OFFLOAD
	select ZVFS_EVENTFD
	help
	  Owner-only sockets, fixed peer and latched eventfd waiting. Optional
	  selected transport decoder; no adapter thread or heap.

config WIRELINK_ZEPHYR_HOT_IRAM
	bool "Place Wirelink core hot paths in ESP32 IRAM"
	depends on SOC_FAMILY_ESPRESSIF_ESP32
	default y
	help
	  Map WL_HOT_ATTR core functions into .iram1 on ESP32 targets to avoid
	  ICache misses on high-rate transport loops at the cost of IRAM.
endif
endmenu
```
